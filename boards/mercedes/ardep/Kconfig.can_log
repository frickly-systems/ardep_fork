## boards/mercedes/ardep/Kconfig.can_log
```kconfig
# Copyright (C) Frickly Systems GmbH
# Copyright (C) MBition GmbH
#
# SPDX-License-Identifier: Apache-2.0

# Enable CAN logging per default
config LOG
	default y

config CAN_LOG
	default y

# Provide CAN log Address via gearshift address providers
config GEARSHIFT_CAN_LOG_ADDRESS_PROVIDER
	default y
```

## boards/mercedes/ardep/Kconfig.uds
```kconfig
# Copyright (C) Frickly Systems GmbH
# Copyright (C) MBition GmbH
#
# SPDX-License-Identifier: Apache-2.0

# enable UDS module per default

config UDS
	default y

config ISO14229
	default y

config CAN
	default y

# Disable zephyr iso-tp module as we use an external module
config ISOTP
	default n

config FLASH
    default y

config STREAM_FLASH
    default y

config IMG_MANAGER
    default y

config IMG_ERASE_PROGRESSIVELY
    default y

config REBOOT
    default y
```

## boards/shields/hv_shield_v2/Kconfig.defconfig
```kconfig
if SHIELD_HV_SHIELD_V2
  config GPIO
    default y
  
  config I2C
    default y
endif
```

## boards/shields/power_io_shield/Kconfig.defconfig
```kconfig
if SHIELD_POWER_IO_SHIELD
  config GPIO
    default y

  config I2C
    default y

  config POWER_IO_SHIELD
    default y
endif
```

## boards/shields/power_io_shield/Kconfig.shield
```kconfig
# Copyright (C) Frickly Systems GmbH
# Copyright (C) MBition GmbH
#
# SPDX-License-Identifier: Apache-2.0

config SHIELD_POWER_IO_SHIELD
  def_bool $(shields_list_contains,power_io_shield)
```

## drivers/binary_encoded_gpio/Kconfig
```kconfig
menuconfig BINARY_ENCODED_GPIO
  bool
  prompt "Binary Encoded GPIO Driver"
  imply GPIO

if BINARY_ENCODED_GPIO
  module = BINARY_ENCODED_GPIO
  module-str = Binary Encoded GPIO Driver
  source "subsys/logging/Kconfig.template.log_config"

  config BINARY_ENCODED_GPIO_INIT_PRIORITY
    int
    prompt "Binary Encoded GPIO Driver init priority"
    default 42
endif
```

## drivers/gearshift/Kconfig
```kconfig
menuconfig GEARSHIFT
  bool
  prompt "Gearshift Driver"
  imply GPIO

if GEARSHIFT
  module = GEARSHIFT
  module-str = Gearshift Driver
  source "subsys/logging/Kconfig.template.log_config"

  config GEARSHIFT_INIT_PRIORITY
    int
    prompt "Gearshift Driver init priority"
    default 42
endif
```

## drivers/hv_shield_v2/Kconfig
```kconfig
menuconfig HV_SHIELD_V2
  bool
  prompt "HV Shield Driver"
  depends on GPIO && I2C

if HV_SHIELD_V2
  module = HV_SHIELD_V2
  module-str = HV Shield V2
  source "subsys/logging/Kconfig.template.log_config"

  config HV_SHIELD_V2_INIT_PRIORITY
    int
    prompt "HV Shield V2 init priority"
    default I2C_INIT_PRIORITY

  config EMUL_HV_SHIELD_V2
    bool
    prompt "HV Shield V2 Emulator"
    depends on EMUL
    default n
endif
```

## drivers/i2c/Kconfig
```kconfig
config I2C_FAKE
	bool "Fake I2C driver"
	default y
  depends on I2C
	depends on DT_HAS_I2C_FAKE_ENABLED
	help
	  Enable support for the FFF-based fake I2C driver.
```

## dts/bindings/gearshift/ardep-gearshift.yaml
```yaml
# Copyright (C) Frickly Systems GmbH
# Copyright (C) MBition GmbH

description: Driver for reading the current gearshift position
compatible: "ardep-gearshift"
include: base.yaml

properties:
  gearshift-gpios:
    type: phandle-array
    required: true
    description: GPIOs connected to the gearshift position pins
```

## dts/bindings/gpio/hv-shield-v2-custom.yaml
```yaml
description: HV shield v2 gpio nexus driver binding.

compatible: "hv-shield-v2-custom"

include: [gpio-controller.yaml, i2c-device.yaml]

properties:
  "#gpio-cells":
    const: 2

  int-gpios:
    required: true
    description: "GPIOs used for HV shield v2 interrupts. Can be shared across multiple hv shields"
    type: "phandle-array"

gpio-cells:
  - pin
  - flags
```

## dts/bindings/gpio/hv-shield-v2.yaml
```yaml
description: HV shield v2 gpio nexus driver binding.

compatible: "hv-shield-v2"

include: [gpio-nexus.yaml, base.yaml]

properties:
  "#gpio-cells":
    const: 3
```

## dts/bindings/gpio/power_io_shield.yaml
```yaml
description: Power IO shield gpio nexus driver binding.

compatible: "power-io-shield"

include: [gpio-controller.yaml, i2c-device.yaml]

properties:
  "#gpio-cells":
    const: 2

  int-gpios:
    required: false # todo: true
    description: "GPIOs used for HV shield v2 interrupts. Can be shared across multiple hv shields"
    type: "phandle-array"

gpio-cells:
  - pin
  - flags
```

## dts/bindings/gpio/zephyr,binary-encoded-gpio.yaml
```yaml
# Copyright (C) Frickly Systems GmbH
# Copyright (C) MBition GmbH

description: Driver for reading binary encoded GPIO input values
compatible: "zephyr,binary-encoded-gpio"
include: base.yaml

properties:
  input-gpios:
    type: phandle-array
    required: true
    description: GPIOs connected to the binary encoded input pins
```

## dts/bindings/i2c/i2c-fake.yaml
```yaml
description: WCH I2C controller
compatible: "i2c-fake"

include: [i2c-controller.yaml]

properties:
  reg:
    required: true
```

## lib/Kconfig
```kconfig
# Copyright (C) Frickly Systems GmbH
# Copyright (C) MBition GmbH
#
# SPDX-License-Identifier: Apache-2.0

menu "ARDEP"

    rsource "iso14229/Kconfig"

    config UDS_USE_NEW_LIB
        bool "Use the new UDS lib implementation"
        default y
        help
            Disable to use the legacy UDS implementation instead.


    if ! UDS_USE_NEW_LIB
    menuconfig UDS
        bool "UDS"
        depends on CAN
        depends on ISOTP

        depends on CAN_MAX_FILTER >= 8

        depends on BOOTLOADER_MCUBOOT
        depends on IMG_MANAGER
        depends on REBOOT

        if UDS
            rsource "uds/Kconfig"
        endif # UDS
    endif # ! UDS_USE_NEW_LIB
    
    if UDS_USE_NEW_LIB
        menuconfig UDS
        bool "UDS"
        select ISO14229

        rsource "uds_new/Kconfig"
    endif # UDS_USE_NEW_LIB

    menuconfig CAN_ROUTER
        bool "Can frame router"
        depends on CAN
        help
            Route can frames from one can device to another using filters

    if CAN_ROUTER
        rsource "can_router/Kconfig"
    endif
endmenu
```

## lib/can_log/Kconfig
```kconfig
# Copyright (C) Frickly Systems GmbH
# Copyright (C) MBition GmbH
#
# SPDX-License-Identifier: Apache-2.0

menuconfig CAN_LOG
    bool "CAN Log Backend"
    depends on CAN
    depends on LOG
    # this currently only works with deferred or immediate log mode
    depends on LOG_MODE_DEFERRED || LOG_MODE_IMMEDIATE
    default n
    help
        Enable CAN logging backend. This backend sends log messages as raw CAN Frames on a specified CAN Identifier.
        It works best in Deferred mode with LOG_PROCESS_THREAD configuration enabled.


if CAN_LOG
    module = CAN_LOG
    module-str = CAN Logger
    source "subsys/logging/Kconfig.template.log_config"


    config CAN_LOG_ADDRESS_PROVIDER_EXTERNAL
        bool "External CAN Log ID Provider"
        default n
        help
          Use an external address provider to get the CAN ID for logging messages.
          This requires an external module that implements the address provider interface.

    if !CAN_LOG_ADDRESS_PROVIDER_EXTERNAL
        config CAN_LOG_ID
            hex
            prompt "CAN Log ID"
            default 0x100
            help
              CAN identifier used for logging messages.
    endif # CAN_LOG_ADDRESS_PROVIDER_EXTERNAL

    config CAN_LOG_SEND_TIMEOUT_MS
        int "CAN Log Send Timeout (ms)"
        default 10
        help
          Timeout in milliseconds for sending CAN log messages.
          Used as a timeout for waiting until a queue slot is free
          for sending and for waiting until the message is sent itself.

    config CAN_LOG_AUTOSTART_BUS
        bool "Auto-start CAN bus for logging"
        default n
        help
          If enabled, the CAN bus used for logging will be automatically
          started during CAN log backend initialization.

    if CAN_LOG_AUTOSTART_BUS
        config CAN_LOG_AUTOSTART_BUS_PRIORITY
            int
            prompt "CAN Log Auto-start Bus Priority"
            default CAN_INIT_PRIORITY
            help
              Priority used when starting the CAN bus for logging.
    endif # CAN_LOG_AUTOSTART_BUS
endif
```

## lib/uds/Kconfig
```kconfig
# Copyright (C) Frickly Systems GmbH
# Copyright (C) MBition GmbH
#
# SPDX-License-Identifier: Apache-2.0

menuconfig UDS
    bool "UDS"
    select ISO14229
    imply REBOOT

if UDS 

    module = UDS
    module-str = UDS
    source "subsys/logging/Kconfig.template.log_config"

    config UDS_USE_DYNAMIC_REGISTRATION
        bool "Allow registering new event handlers at runtime"
        default n

    menuconfig UDS_UPLOAD_DOWNLOAD_MODULE
        bool "module to allow uploading and downloading of big chunks for data"
        select FLASH
        select FLASH_MAP
        default y

    if UDS_UPLOAD_DOWNLOAD_MODULE

        config UDS_FILE_TRANSFER
            bool "feature of upload download module that allows file transfer"
            depends on FILE_SYSTEM
            default y

        config UDS_UPLOAD_MAX_PAYLOAD_SIZE
            int "Maximum TransferData payload size for upload"
            default 128
            help
                Maximum size of each TransferData payload during upload.
                This value can also be limited by other factors, this is just a user-specified maximum

    endif # UDS_UPLOAD_DOWNLOAD_MODULE

    menuconfig UDS_USE_LINK_CONTROL
        bool "Enable LinkControl service (0x87)"
        default n
        help
          Enable support for the LinkControl service (0x87). This service allows
          switching the CAN bitrate at runtime.
          
    if UDS_USE_LINK_CONTROL

        config UDS_DEFAULT_CAN_BITRATE
            int "Default CAN bitrate"
            default 500000
            help
              Default CAN bitrate for UDS communication. When using the LinkControl
              function and the can interface gets reset to its default bitrate,
              this value is used.
    
    endif # UDS_USE_LINK_CONTROL

    menuconfig UDS_DEFAULT_INSTANCE
        bool "Enable default UDS instance"
        default y

    if UDS_DEFAULT_INSTANCE
        config UDS_DEFAULT_INSTANCE_AUTOSTART_PRIORITY
            int "Default UDS instance autostart priority"
            default APPLICATION_INIT_PRIORITY

        config UDS_DEFAULT_INSTANCE_DISABLE_SWITCH_TO_FIRMWARE_LOADER
            bool "Disable switch to firmware loader"
            default n
            help
                If enabled, switching to the firmware loader via Programming session is not enabled.
                Receivng a switch to programming session request is thus not handled.

        config UDS_DEFAULT_INSTANCE_EXTERNAL_ADDRESS_PROVIDER
            bool "Use external address provider for default UDS instance"
            default n
            help
                If enabled, a function is defined, but not implemented, which can be overwitten to provide
                custom CAN IDs for the default UDS instance.
                If disabled, default CAN IDs from the configuration are used.
        if !UDS_DEFAULT_INSTANCE_EXTERNAL_ADDRESS_PROVIDER
            config UDS_DEFAULT_INSTANCE_SOURCE_ADDRESS
                hex "Default UDS instance Source CAN ID"
                default 0x7E8
                help
                    CAN ID for receiving UDS requests.

            config UDS_DEFAULT_INSTANCE_TARGET_ADDRESS
                hex "Default UDS instance Target CAN ID"
                default 0x7E0
                help
                    CAN ID for sending UDS responses.

            config UDS_DEFAULT_INSTANCE_FUNCTIONAL_SOURCE_ADDRESS
                hex "Default UDS instance Functional Source CAN ID"
                default 0x7DF
                help
                    CAN ID for receiving functional UDS requests.
                    Can be set to 0xFFFFFFFF to disable functional addressing.

            config UDS_DEFAULT_INSTANCE_FUNCTIONAL_TARGET_ADDRESS
                hex "Default UDS instance Functional Target CAN ID"
                default 0xFFFFFFFF
                help
                    CAN ID for sending functional UDS responses.
                    Can be set to 0xFFFFFFFF to disable functional addressing.
        endif # !UDS_DEFAULT_INSTANCE_EXTERNAL_ADDRESS_PROVIDER

    endif # UDS_DEFAULT_INSTANCE
endif # UDS
```

## lib/uds_frickly/Kconfig
```kconfig
# Copyright (C) Frickly Systems GmbH
# Copyright (C) MBition GmbH
#
# SPDX-License-Identifier: Apache-2.0

menuconfig UDS_FRICKLY
    bool "UDS New"
    select ISO14229
    
if UDS_FRICKLY

module = UDS_FRICKLY
module-str = UDS new
source "subsys/logging/Kconfig.template.log_config"

config UDS_FRICKLY_ENABLE_RESET
    bool "Enable reboot/reset from ECU reset command"
    default y
    select REBOOT

config UDS_FRICKLY_RESET_DELAY_MS
    int "Delay for the default ecu reset handling by this time (minimum of p2 is forced to ensure a response is send)"
    default 0
    depends on UDS_FRICKLY_ENABLE_RESET

config UDS_FRICKLY_USE_DYNAMIC_DATA_BY_ID
    bool "Delay for the default ecu reset handling by this time (minimum of p2 is forced to ensure a response is send)"
    default y

endif # UDS_FRICKLY
```

## lib/uds_minimal/Kconfig
```kconfig
# Copyright (C) Frickly Systems GmbH
# Copyright (C) MBition GmbH
#
# SPDX-License-Identifier: Apache-2.0

menuconfig UDS_MINIMAL
    bool "UDS Minimal support"
    select MODULE_ISO14229_EXTERNAL
    
if UDS_MINIMAL

module = UDS_MINIMAL
module-str = UDS minimal
source "subsys/logging/Kconfig.template.log_config"

endif # UDS_MINIMAL
```

## lib/uds_new/Kconfig
```kconfig
# Copyright (C) Frickly Systems GmbH
# Copyright (C) MBition GmbH
#
# SPDX-License-Identifier: Apache-2.0

module = UDS
module-str = UDS
source "subsys/logging/Kconfig.template.log_config"

config UDS_USE_DYNAMIC_REGISTRATION
    bool "Allow registering new event handlers at runtime"
    default n
```

## modules/iso14229/Kconfig
```kconfig
# config ZEPHYR_TRUSTED_FIRMWARE_A_MODULE

config MODULE_ISO14229_EXTERNAL
  bool "ISO14229 Library"
  depends on ZEPHYR_ISO14229_MODULE
  depends on CAN

if MODULE_ISO14229_EXTERNAL

  module = MODULE_ISO14229_EXTERNAL
  module-str = External ISO14229 Library
  source "subsys/logging/Kconfig.template.log_config"

endif
```

## samples/gearshift/sample.yaml
```yaml
# Copyright (C) Frickly Systems GmbH
# Copyright (C) MBition GmbH

sample:
  name: Gearshift
common:
  build_only: true
  integration_platforms:
    - ardep
tests:
  example.gearshift.default: {}
```

## samples/hv_shield_v2/sample.yaml
```yaml
sample:
  name: HV Shield V2 sample
common:
  build_only: true
  integration_platforms:
    - ardep
tests:
  example.hv_shield_v2.default: {}
```
