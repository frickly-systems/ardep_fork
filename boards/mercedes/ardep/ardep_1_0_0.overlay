/*
 * Copyright (c) 2019 STMicroelectronics.
 * Copyright (C) Frickly Systems GmbH
 * Copyright (C) MBition GmbH
 *
 * SPDX-License-Identifier: Apache-2.0
 */

/ {
    model = "Automotive Rapid Development board v1.0.0";

    chosen {
        zephyr,console = &usb_cdc_acm;
    };
};

zephyr_udc0: &usb {
    pinctrl-0 = <&usb_dm_pa11 &usb_dp_pa12>;
    pinctrl-names = "default";
    status = "okay";

    usb_cdc_acm: usb-cdc-acm {
        status = "okay";
        compatible = "zephyr,cdc-acm-uart";
    };
};
