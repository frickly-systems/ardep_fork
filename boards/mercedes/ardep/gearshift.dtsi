/*
 * SPDX-FileCopyrightText: Copyright (C) 2025 Frickly Systems GmbH
 * SPDX-FileCopyrightText: Copyright (C) 2025 MBition GmbH
 *
 * SPDX-License-Identifier: Apache-2.0
 */

/ {
    gearshift: gearshift {
        compatible = "zephyr,binary-encoded-gpio";
        input-gpios = <&gpioc 13 (GPIO_ACTIVE_LOW|GPIO_PULL_UP)>,
                      <&gpioc 1  (GPIO_ACTIVE_LOW|GPIO_PULL_UP)>,
                      <&gpiof 1  (GPIO_ACTIVE_LOW|GPIO_PULL_UP)>;
        status = "okay";
    };
};
