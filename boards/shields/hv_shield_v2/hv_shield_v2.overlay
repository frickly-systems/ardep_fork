#include <ardep/dt-bindings/hv-shield-v2.h>

&i2c2 {
	status = "okay";

	hv_shield0: hv_shield0@20 {
		compatible = "hv-shield-v2-custom";
		int-gpios = <&gpioe 2 (GPIO_ACTIVE_LOW|GPIO_PULL_UP)>, <&gpioe 5 (GPIO_ACTIVE_LOW|GPIO_PULL_UP)>;
		// todo: check if pullup is needed
		reg = <0x20>;
		gpio-controller;
		#gpio-cells = <2>;
	};
};
