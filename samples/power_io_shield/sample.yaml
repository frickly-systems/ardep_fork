## samples/power_io_shield/sample.yaml
```yaml
sample:
  name: HV Shield V2 sample
common:
  build_only: true
  integration_platforms:
    - ardep
tests:
  example.power_io_shield.default: {}
```

## tests/drivers/hv_shield_v2/testcase.yaml
```yaml
# Copyright (C) Frickly Systems GmbH
# Copyright (C) MBition GmbH
#
# SPDX-License-Identifier: Apache-2.0

common:
  tags: drivers, hv_shield_v2
  platform_allow:
    - native_sim/native/64
    - native_sim

tests:
  drivers.hv_shield_v2:
    harness: ztest
```

## west.yml
```yaml
manifest:
  self:
    path: ardep
    west-commands: scripts/west-commands.yml
  # Add zephyrs optional group to allow access to nanopb
  group-filter: [+optional]

  remotes:
    - name: zephyrproject-rtos
      url-base: https://github.com/zephyrproject-rtos
    - name: frickly-systems
      url-base: https://github.com/frickly-systems

  projects:
    - name: zephyr
      remote: zephyrproject-rtos
      revision: v4.2.0
      import:
        name-allowlist:
          - cmsis_6
          - hal_stm32
          - segger
          - hal_st
          - mcuboot
          - mbedtls
          - littlefs
          - nanopb
    - name: zephboards
      url: https://github.com/dragonlock2/zephyrboards.git
      revision: 9443ad0ebe547a140ec54790687ae8b4d4e0cd34
    - name: iso14229
      remote: frickly-systems
      revision: zephyr
```
