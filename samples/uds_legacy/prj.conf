## prj.conf
```kconfig
CONFIG_CAN=y
CONFIG_ISOTP=y

CONFIG_CAN_MAX_FILTER=12

CONFIG_FLASH=y
CONFIG_STREAM_FLASH=y
CONFIG_IMG_MANAGER=y
CONFIG_REBOOT=y
CONFIG_UDS_LEGACY=y
CONFIG_UDS=n
CONFIG_ISO14229=n

CONFIG_LOG=y
CONFIG_UDS_LEGACY_LOG_LEVEL_DBG=y
```

## src/main.c
```c
/*
 * Copyright (C) Frickly Systems GmbH
 * Copyright (C) MBition GmbH
 *
 * SPDX-License-Identifier: Apache-2.0
 */

#include <zephyr/kernel.h>

#if !CONFIG_UDS_LEGACY
#error "This sample requires the CONFIG_UDS_LEGACY option enabled"
#endif

int main(void) { printk("Hello UDS!\n"); }
```
