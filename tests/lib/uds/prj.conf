## prj.conf
```kconfig
CONFIG_ZTEST=y
CONFIG_ASSERT=y
CONFIG_CAN_FAKE=y
CONFIG_CAN=y
CONFIG_CAN_MAX_FILTER=12

CONFIG_UDS=y
CONFIG_UDS_DEFAULT_INSTANCE=n
CONFIG_UDS_USE_DYNAMIC_REGISTRATION=y
CONFIG_UDS_USE_LINK_CONTROL=y

CONFIG_LOG=y
CONFIG_LOG_INFO_COLOR_GREEN=y
CONFIG_CAN_LOG=n

# Enable heap allocation for k_malloc
CONFIG_HEAP_MEM_POOL_SIZE=1024
CONFIG_STD_C11=y

# Filesystem support for UDS file transfer tests
CONFIG_FILE_SYSTEM=y
CONFIG_FILE_SYSTEM_LITTLEFS=y
CONFIG_FLASH_MAP=y
CONFIG_FLASH_PAGE_LAYOUT=y
CONFIG_FS_LOG_LEVEL_OFF=y # do not clutter test output with FS logs
```

## src/fixture.c
```c
/*
 * Copyright (C) Frickly Systems GmbH
 * Copyright (C) MBition GmbH
 *
 * SPDX-License-Identifier: Apache-2.0
 */

#include "ardep/uds_macro.h"
#include "fixture.h"
#include "iso14229.h"

#include <errno.h>
#include <string.h>

#include <zephyr/drivers/can.h>
#include <zephyr/drivers/can/can_fake.h>
#include <zephyr/fs/fs.h>
#include <zephyr/fs/littlefs.h>
#include <zephyr/storage/flash_map.h>
#include <zephyr/ztest.h>

DEFINE_FFF_GLOBALS;

DEFINE_FAKE_VALUE_FUNC(uint8_t, copy, UDSServer_t *, const void *, uint16_t);

DEFINE_FAKE_VALUE_FUNC(uint8_t, set_auth_state, UDSServer_t *, uint8_t);

DEFINE_FAKE_VALUE_FUNC(UDSErr_t,
                       data_id_check_fn,
                       const struct uds_context *const,
                       bool *);

DEFINE_FAKE_VALUE_FUNC(UDSErr_t,
                       data_id_action_fn,
                       struct uds_context *const,
                       bool *);

#define FFF_FAKES_LIST(FAKE) \
  FAKE(copy)                 \
  FAKE(set_auth_state)       \
  FAKE(data_id_check_fn)     \
  FAKE(data_id_action_fn)

struct uds_instance_t fixture_uds_instance;

#ifdef CONFIG_UDS_USE_DYNAMIC_REGISTRATION
bool test_dynamic_registration_check_invoked;
bool test_dynamic_registration_action_invoked;
#endif  // # CONFIG_UDS_USE_DYNAMIC_REGISTRATION

const uint16_t data_id_r = 1;
uint8_t data_id_r_data[4];

const uint16_t data_id_rw = 2;
uint8_t data_id_rw_data[4];

const uint16_t data_id_rw_duplicated1 = 3;
const uint16_t data_id_rw_duplicated2 = 3;
uint8_t data_id_rw_duplicated_data[4];

const uint16_t routine_id = 0xDEAD;

UDS_REGISTER_DATA_BY_IDENTIFIER_HANDLER(&fixture_uds_instance,
                                        data_id_r,
                                        data_id_r_data,
                                        // read
                                        data_id_check_fn,
                                        data_id_action_fn,
                                        // write
                                        NULL,
                                        NULL,
                                        // io control
                                        NULL,
                                        NULL,
                                        NULL)

UDS_REGISTER_DATA_BY_IDENTIFIER_HANDLER(&fixture_uds_instance,
                                        data_id_rw,
                                        data_id_rw_data,
                                        // read
                                        data_id_check_fn,
                                        data_id_action_fn,
                                        // write
                                        data_id_check_fn,
                                        data_id_action_fn,
                                        // io control
                                        data_id_check_fn,
                                        data_id_action_fn,
                                        NULL)

// Duplicated Registratin for the same data ID
UDS_REGISTER_DATA_BY_IDENTIFIER_HANDLER(&fixture_uds_instance,
                                        data_id_rw_duplicated1,
                                        data_id_rw_duplicated_data,
                                        // read
                                        data_id_check_fn,
                                        data_id_action_fn,
                                        // write
                                        data_id_check_fn,
                                        data_id_action_fn,
                                        // io control
                                        data_id_check_fn,
                                        data_id_action_fn,
                                        NULL)

UDS_REGISTER_DATA_BY_IDENTIFIER_HANDLER(&fixture_uds_instance,
                                        data_id_rw_duplicated2,
                                        data_id_rw_duplicated_data,
                                        // read
                                        data_id_check_fn,
                                        data_id_action_fn,
                                        // write
                                        data_id_check_fn,
                                        data_id_action_fn,
                                        // io control
                                        data_id_check_fn,
                                        data_id_action_fn,
                                        NULL)

UDS_REGISTER_ECU_RESET_HANDLER(&fixture_uds_instance,
                               ECU_RESET__KEY_OFF_ON,
                               // ecu_reset
                               data_id_check_fn,
                               data_id_action_fn,
                               // do_scheduled_reset
                               data_id_check_fn,
                               data_id_action_fn,
                               NULL)

UDS_REGISTER_MEMORY_DEFAULT_HANDLER(&fixture_uds_instance)

UDS_REGISTER_DIAG_SESSION_CTRL_HANDLER(&fixture_uds_instance,
                                       // diag_session_ctrl
                                       data_id_check_fn,
                                       data_id_action_fn,
                                       // session_timeout
                                       data_id_check_fn,
                                       data_id_action_fn,
                                       NULL)

UDS_REGISTER_READ_DTC_INFO_HANDLER_ALL(&fixture_uds_instance,
                                       data_id_check_fn,
                                       data_id_action_fn,
                                       NULL)

UDS_REGISTER_CLEAR_DIAG_INFO_HANDLER(&fixture_uds_instance,
                                     data_id_check_fn,
                                     data_id_action_fn,
                                     NULL)

UDS_REGISTER_ROUTINE_CONTROL_HANDLER(&fixture_uds_instance,
                                     routine_id,
                                     data_id_check_fn,
                                     data_id_action_fn,
                                     NULL)

UDS_REGISTER_SECURITY_ACCESS_HANDLER(&fixture_uds_instance,
                                     data_id_check_fn,
                                     data_id_action_fn,
                                     data_id_check_fn,
                                     data_id_action_fn,
                                     NULL)

UDS_REGISTER_COMMUNICATION_CONTROL_HANDLER(&fixture_uds_instance,
                                           data_id_check_fn,
                                           data_id_action_fn,
                                           NULL)

UDS_REGISTER_CONTROL_DTC_SETTING_HANDLER(&fixture_uds_instance,
                                         data_id_check_fn,
                                         data_id_action_fn,
                                         NULL)

UDS_REGISTER_LINK_CONTROL_HANDLER(&fixture_uds_instance,
                                  data_id_check_fn,
                                  data_id_action_fn,
                                  NULL)

UDS_REGISTER_AUTHENTICATION_HANDLER(&fixture_uds_instance,
                                    data_id_check_fn,
                                    data_id_action_fn,
                                    data_id_check_fn,
                                    data_id_action_fn,
                                    NULL)

UDS_REGISTER_DYNAMICALLY_DEFINE_DATA_IDS_DEFAULT_HANDLER(&fixture_uds_instance)

static const UDSISOTpCConfig_t default_cfg = {
  // Hardware Addresses
  .source_addr = 0x7E8,  // Can ID Server (us)
  .target_addr = 0x7E0,  // Can ID Client (them)

  // Functional Addresses
  .source_addr_func = 0x7DF,             // ID Server (us)
  .target_addr_func = UDS_TP_NOOP_ADDR,  // ID Client (them)
};

static uint8_t copied_data[4096];
static uint32_t copied_len;

void assert_copy_data_offset(const uint8_t *data,
                             uint32_t len,
                             uint32_t offset) {
  zassert_equal(copied_len, len + offset, "Expected length %u, but got %u", len,
                copied_len);
  zassert_mem_equal(copied_data + offset, data, len);
}

void assert_copy_data(const uint8_t *data, uint32_t len) {
  assert_copy_data_offset(data, len, 0);
}

UDSErr_t receive_event(struct uds_instance_t *inst,
                       UDSEvent_t event,
                       void *args) {
  return inst->iso14229.event_callback(&inst->iso14229, event, args, inst);
}

static uint8_t custom_copy(UDSServer_t *server,
                           const void *data,
                           uint16_t len) {
  memcpy(copied_data + copied_len, data, len);
  copied_len += len;

  return 0;
}

static uint8_t auth_state_data;

void assert_auth_state(uint8_t expected_state) {
  zassert_equal(expected_state, auth_state_data);
}

static uint8_t custom_set_auth_state(UDSServer_t *server, uint8_t state) {
  auth_state_data = state;
  return UDS_OK;
}

static void *uds_setup(void) {
  memset(&fixture_uds_instance, 0, sizeof(fixture_uds_instance));

  static struct lib_uds_fixture fixture = {
    .cfg = default_cfg,
    .can_dev = DEVICE_DT_GET(DT_CHOSEN(zephyr_canbus)),
    .instance = &fixture_uds_instance,
  };

  printk("Using CAN device %s\n", fixture.can_dev->name);

  return &fixture;
}

FS_LITTLEFS_DECLARE_DEFAULT_CONFIG(lfs_storage);

static struct fs_mount_t fixture_fs_mount = {
  .type = FS_LITTLEFS,
  .fs_data = &lfs_storage,
  .storage_dev = (void *)FIXED_PARTITION_ID(storage_partition),
  .mnt_point = "/lfs",
};

extern int fixture_fs_wipe(void) {
  const struct flash_area *fa;
  int rc = flash_area_open(FIXED_PARTITION_ID(storage_partition), &fa);

  if (rc < 0) {
    return rc;
  }

  rc = flash_area_erase(fa, 0, fa->fa_size);
  flash_area_close(fa);

  return rc;
}

static void fixture_fs_mount_or_fail(void) {
  fs_unmount(&fixture_fs_mount);

  int rc = fixture_fs_wipe();
  zassert_true(rc >= 0, "flash erase failed (%d)", rc);

  rc = fs_mount(&fixture_fs_mount);
  zassert_equal(rc, 0, "fs_mount failed (%d)", rc);
}

static void uds_before(void *f) {
  struct lib_uds_fixture *fixture = f;
  const struct device *dev = fixture->can_dev;
  struct uds_instance_t *uds_instance = fixture->instance;

  fixture_fs_mount_or_fail();

  FFF_FAKES_LIST(RESET_FAKE);
  FFF_RESET_HISTORY();

  copy_fake.custom_fake = custom_copy;
  set_auth_state_fake.custom_fake = custom_set_auth_state;

  int ret = uds_init(uds_instance, &default_cfg, dev, fixture);
  assert(ret == 0);

  STRUCT_SECTION_FOREACH (uds_registration_t, reg) {
  }

  test_dynamic_registration_check_invoked = false;
  test_dynamic_registration_action_invoked = false;

  data_id_r_data[0] = 0x12;
  data_id_r_data[1] = 0x34;
  data_id_r_data[2] = 0x56;
  data_id_r_data[3] = 0x78;

  data_id_rw_data[0] = 0x87;
  data_id_rw_data[1] = 0x65;
  data_id_rw_data[2] = 0x43;
  data_id_rw_data[3] = 0x21;

  data_id_rw_duplicated_data[0] = 0x11;
  data_id_rw_duplicated_data[1] = 0x22;
  data_id_rw_duplicated_data[2] = 0x33;
  data_id_rw_duplicated_data[3] = 0x44;

  memset(copied_data, 0, sizeof(copied_data));
  copied_len = 0;

  auth_state_data = 0;
}

static void uds_after(void *f) {
  struct lib_uds_fixture *fixture = f;

  fs_unmount(&fixture_fs_mount);

#ifdef CONFIG_UDS_USE_DYNAMIC_REGISTRATION
  struct uds_registration_t *reg;
  struct uds_registration_t *temp;

  SYS_SLIST_FOR_EACH_CONTAINER_SAFE (&fixture->instance->dynamic_registrations,
                                     reg, temp, node) {
    k_free(reg);
  }

  sys_slist_init(&fixture->instance->dynamic_registrations);
#endif
}

ZTEST_SUITE(lib_uds, NULL, uds_setup, uds_before, uds_after, NULL);
```

## src/fixture.h
```c
/*
 * Copyright (C) Frickly Systems GmbH
 * Copyright (C) MBition GmbH
 *
 * SPDX-License-Identifier: Apache-2.0
 */
#ifndef APP_TESTS_LIB_ISO14229_SRC_FIXTURE_H_
#define APP_TESTS_LIB_ISO14229_SRC_FIXTURE_H_

#include "ardep/uds.h"

#include <zephyr/drivers/can.h>
#include <zephyr/drivers/can/can_fake.h>
#include <zephyr/fff.h>

#include <ardep/iso14229.h>
#include <iso14229.h>

DECLARE_FAKE_VALUE_FUNC(uint8_t, copy, UDSServer_t *, const void *, uint16_t);

DECLARE_FAKE_VALUE_FUNC(UDSErr_t, set_auth_state, UDSServer_t *, uint8_t);

DECLARE_FAKE_VALUE_FUNC(UDSErr_t,
                        data_id_check_fn,
                        const struct uds_context *const,
                        bool *);

DECLARE_FAKE_VALUE_FUNC(UDSErr_t,
                        data_id_action_fn,
                        struct uds_context *const,
                        bool *);

extern const uint16_t data_id_r;
extern uint8_t data_id_r_data[4];

extern const uint16_t data_id_rw;
extern uint8_t data_id_rw_data[4];

extern const uint16_t data_id_rw_duplicated1;
extern const uint16_t data_id_rw_duplicated2;
extern uint8_t data_id_rw_duplicated_data[4];

extern const uint16_t routine_id;

#ifdef CONFIG_UDS_USE_DYNAMIC_REGISTRATION
extern bool test_dynamic_registration_check_invoked;
extern bool test_dynamic_registration_action_invoked;
#endif  // # CONFIG_UDS_USE_DYNAMIC_REGISTRATION

struct lib_uds_fixture {
  UDSISOTpCConfig_t cfg;
  struct uds_instance_t *instance;
  const struct device *can_dev;
};

/**
 * @brief Receive an event from iso14229
 */
UDSErr_t receive_event(struct uds_instance_t *inst,
                       UDSEvent_t event,
                       void *args);

/**
 * @brief Assert that the copied data matches the expected data.
 *
 * Beware that the data is in big endian!
 */
void assert_copy_data(const uint8_t *data, uint32_t len);

/**
 * @brief same as `assert_copy_data` but allows to specify an offset
 */
void assert_copy_data_offset(const uint8_t *data,
                             uint32_t len,
                             uint32_t offset);

#endif  // APP_TESTS_LIB_ISO14229_SRC_FIXTURE_H_
```

## src/test_0x10_diag_session_ctrl.c
```c
/*
 * Copyright (C) Frickly Systems GmbH
 * Copyright (C) MBition GmbH
 *
 * SPDX-License-Identifier: Apache-2.0
 */
#include "ardep/uds.h"
#include "fixture.h"

#include <zephyr/ztest.h>

UDSErr_t custom_check_for_0x10_daig_session_ctrl_callback_on_session_change(
    const struct uds_context *const context, bool *apply_action) {
  if (context->registration->type == UDS_REGISTRATION_TYPE__DIAG_SESSION_CTRL) {
    *apply_action = true;
  }
  return UDS_OK;
}

ZTEST_F(lib_uds, test_0x10_daig_session_ctrl_callback_on_session_change) {
  struct uds_instance_t *instance = fixture->instance;

  UDSDiagSessCtrlArgs_t args = {
    .type = 0x02,  // programming session
    .p2_ms = 0x100,
    .p2_star_ms = 0x200,
  };

  int ret = receive_event(instance, UDS_EVT_DiagSessCtrl, &arg);
  zassert_ok(ret);

  zassert_true(data_id_check_fn_fake.call_count >= 1);
  zassert_equal(data_id_action_fn_fake.call_count, 1);
}
```

## src/test_0x11_ecu_reset.c
```c
/*
 * Copyright (C) Frickly Systems GmbH
 * Copyright (C) MBition GmbH
 *
 * SPDX-License-Identifier: Apache-2.0
 */
#include "fixture.h"

#include <zephyr/ztest.h>

UDSErr_t custom_check_for_0x11_return_subfunc_not_sup(
    const struct uds_context *const context, bool *apply_action) {
  if (context->registration->type == uds_registration_tYPE__ECU_RESET &&
      context->event == UDS_EVT_EcuReset) {
    UDSECUResetArgs_t *args = context->arg;
    if (args->type == ECU_RESET__KEY_OFF_ON) {
      *apply_action = true;
    }
  }
  return UDS_OK;
}

UDSErr_t custom_action_for_0x11_return_subfunc_not_sup(
    struct uds_context *const context, bool *consume_event) {
  if (context->registration->type == uds_registration_tYPE__ECU_RESET &&
      context->event == UDS_EVT_EcuReset) {
    UDSECUResetArgs_t *args = context->arg;
    if (args->type == ECU_RESET__KEY_OFF_ON) {
      *consume_event = true;
    }
  }
  return UDS_OK;
}

ZTEST_F(lib_uds, test_0x11_ecu_reset_return_subfunc_not_sup) {
  struct uds_instance_t *instance = fixture->instance;

  data_id_check_fn_fake.custom_fake =
      custom_check_for_0x11_return_subfunc_not_sup;
  data_id_action_fn_fake.custom_fake =
      custom_action_for_0x11_return_subfunc_not_sup;

  UDSECUResetArgs_t arg = {
    .type = ECU_RESET__HARD,
    .powerDownTimeMillis = 500,
  };

  int ret = receive_event(instance, UDS_EVT_EcuReset, &arg);
  zassert_equal(ret, UDS_NRC_SubFunctionNotSupported);
}

/////////////////////////////////

UDSErr_t custom_check_for_0x11_ecu_reset_event_works(
    const struct uds_context *const context, bool *apply_action) {
  if (context->registration->type == uds_registration_tYPE__ECU_RESET &&
      context->event == UDS_EVT_EcuReset) {
    UDSECUResetArgs_t *args = context->arg;
    if (args->type == ECU_RESET__KEY_OFF_ON) {
      *apply_action = true;
    }
  }
  return UDS_OK;
}

UDSErr_t custom_action_for_0x11_ecu_reset_event_works(
    struct uds_context *const context, bool *consume_event) {
  if (context->registration->type == uds_registration_tYPE__ECU_RESET &&
      context->event == UDS_EVT_EcuReset) {
    UDSECUResetArgs_t *args = context->arg;
    if (args->type == ECU_RESET__KEY_OFF_ON) {
      *consume_event = true;
    }
  }
  return UDS_OK;
}

ZTEST_F(lib_uds, test_0x11_ecu_reset_ecu_reset_event_works) {
  struct uds_instance_t *instance = fixture->instance;

  data_id_check_fn_fake.custom_fake =
      custom_check_for_0x11_ecu_reset_event_works;
  data_id_action_fn_fake.custom_fake =
      custom_action_for_0x11_ecu_reset_event_works;

  UDSECUResetArgs_t arg = {
    .type = ECU_RESET__KEY_OFF_ON,
    .powerDownTimeMillis = 500,
  };

  int ret = receive_event(instance, UDS_EVT_EcuReset, &arg);
  zassert_ok(ret);

  zassert_true(data_id_check_fn_fake.call_count >= 1);
  zassert_equal(data_id_action_fn_fake.call_count, 1);
}

/////////////////////////////////

UDSErr_t custom_check_for_0x11_do_scheduled_reset_event_works(
    const struct uds_context *const context, bool *apply_action) {
  if (context->registration->type == uds_registration_tYPE__ECU_RESET &&
      context->event == UDS_EVT_DoScheduledReset) {
    if (*(uint32_t *)context->arg == ECU_RESET__KEY_OFF_ON) {
      *apply_action = true;
    }
  }
  return UDS_OK;
}

UDSErr_t custom_action_for_0x11_do_scheduled_reset_event_works(
    struct uds_context *const context, bool *consume_event) {
  if (context->registration->type == uds_registration_tYPE__ECU_RESET &&
      context->event == UDS_EVT_DoScheduledReset) {
    if (*(uint32_t *)context->arg == ECU_RESET__KEY_OFF_ON) {
      *consume_event = true;
    }
  }
  return UDS_OK;
}

ZTEST_F(lib_uds, test_0x11_ecu_reset_do_scheduled_reset_event_works) {
  struct uds_instance_t *instance = fixture->instance;

  data_id_check_fn_fake.custom_fake =
      custom_check_for_0x11_do_scheduled_reset_event_works;
  data_id_action_fn_fake.custom_fake =
      custom_action_for_0x11_do_scheduled_reset_event_works;

  uint32_t reset_type = ECU_RESET__KEY_OFF_ON;
  ;

  int ret = receive_event(instance, UDS_EVT_DoScheduledReset, &reset_type);
  zassert_ok(ret);

  zassert_true(data_id_check_fn_fake.call_count >= 1);
  zassert_equal(data_id_action_fn_fake.call_count, 1);
}
```

## src/test_0x19_read_dtc_info.c
```c
/*
 * Copyright (C) Frickly Systems GmbH
 * Copyright (C) MBition GmbH
 *
 * SPDX-License-Identifier: Apache-2.0
 */

#include "fixture.h"

#include <zephyr/ztest.h>

UDSErr_t read_dtc_info_0x01_check_fn(const struct uds_context *const context,
                                     bool *apply_action) {
  zassert_equal(context->event, UDS_EVT_ReadDTCInformation);
  UDSRDTCIArgs_t *args = context->arg;
  zassert_not_null(args);
  zassert_equal(args->type, READ_DTC_INFO_SUBFUNC__NUM_OF_DTC_BY_STATUS_MASK);
  *apply_action = true;
  return UDS_OK;
}

UDSErr_t read_dtc_info_0x01_action_fn(struct uds_context *const context,
                                      bool *consume_event) {
  UDSRDTCIArgs_t *args = context->arg;
  zassert_equal(args->type, READ_DTC_INFO_SUBFUNC__NUM_OF_DTC_BY_STATUS_MASK);

  copy(&context->instance->iso14229.server, (uint8_t[]){0x01, 0x02, 0x03}, 3);

  return UDS_OK;
}

ZTEST_F(lib_uds, test_0x19_read_dtc_info_0x01_num_of_dtc_by_status_mask) {
  struct uds_instance_t *instance = fixture->instance;

  UDSRDTCIArgs_t args = {
    .type = READ_DTC_INFO_SUBFUNC__NUM_OF_DTC_BY_STATUS_MASK,
    .copy = copy,
  };

  data_id_check_fn_fake.custom_fake = read_dtc_info_0x01_check_fn;
  data_id_action_fn_fake.custom_fake = read_dtc_info_0x01_action_fn;

  int ret = receive_event(instance, UDS_EVT_ReadDTCInformation, &args);
  zassert_ok(ret);

  zassert_equal(data_id_action_fn_fake.call_count, 1);
  assert_copy_data((uint8_t[]){0x01, 0x02, 0x03}, 3);
}

UDSErr_t read_dtc_info_0x02_nrc_check_fn(
    const struct uds_context *const context, bool *apply_action) {
  zassert_equal(context->event, UDS_EVT_ReadDTCInformation);
  UDSRDTCIArgs_t *args = context->arg;
  zassert_not_null(args);
  zassert_equal(args->type, READ_DTC_INFO_SUBFUNC__DTC_BY_STATUS_MASK);
  *apply_action = true;
  return UDS_OK;
}

UDSErr_t read_dtc_info_0x02_nrc_action_fn(struct uds_context *const context,
                                          bool *consume_event) {
  UDSRDTCIArgs_t *args = context->arg;
  zassert_equal(args->type, READ_DTC_INFO_SUBFUNC__DTC_BY_STATUS_MASK);

  return UDS_NRC_RequestOutOfRange;
}

ZTEST_F(lib_uds, test_0x19_read_dtc_info_0x02_dtc_by_status_mask_return_nrc) {
  struct uds_instance_t *instance = fixture->instance;

  UDSRDTCIArgs_t args = {
    .type = READ_DTC_INFO_SUBFUNC__DTC_BY_STATUS_MASK,
    .copy = copy,
  };

  data_id_check_fn_fake.custom_fake = read_dtc_info_0x02_nrc_check_fn;
  data_id_action_fn_fake.custom_fake = read_dtc_info_0x02_nrc_action_fn;

  int ret = receive_event(instance, UDS_EVT_ReadDTCInformation, &args);
  zassert_equal(ret, UDS_NRC_RequestOutOfRange);
}
```

## src/test_0x22_read_data_by_id.c
```c
/*
 * Copyright (C) Frickly Systems GmbH
 * Copyright (C) MBition GmbH
 *
 * SPDX-License-Identifier: Apache-2.0
 */

#include "fixture.h"

#include <zephyr/ztest.h>

ZTEST_F(lib_uds, test_0x22_read_by_id_fails_when_no_action_applies) {
  struct uds_instance_t *instance = fixture->instance;

  UDSRDBIArgs_t arg = {
    .dataId = data_id_r,
    .copy = copy,
  };

  int ret = receive_event(instance, UDS_EVT_ReadDataByIdent, &arg);
  zassert_equal(ret, UDS_NRC_RequestOutOfRange);
  zassert_true(data_id_check_fn_fake.call_count >= 1);
  zassert_equal(data_id_action_fn_fake.call_count, 0);
}

//////////////////////7

UDSErr_t custom_check_for_0x22_applies_action_when_check_succeeds(
    const struct uds_context *const context, bool *apply_action) {
  if (context->registration->type == UDS_REGISTRATION_TYPE__DATA_IDENTIFIER &&
      context->registration->data_identifier.data_id == data_id_r &&
      context->event == UDS_EVT_ReadDataByIdent) {
    *apply_action = true;
  }
  return UDS_OK;
}

ZTEST_F(lib_uds, test_0x22_read_by_id_applies_action_when_check_succeeds) {
  struct uds_instance_t *instance = fixture->instance;

  data_id_check_fn_fake.custom_fake =
      custom_check_for_0x22_applies_action_when_check_succeeds;

  UDSRDBIArgs_t arg = {
    .dataId = data_id_r,
    .copy = copy,
  };

  int ret = receive_event(instance, UDS_EVT_ReadDataByIdent, &arg);
  zassert_ok(ret);

  zassert_true(data_id_check_fn_fake.call_count >= 1);
  zassert_equal(data_id_action_fn_fake.call_count, 1);
}

//////////////////////7

UDSErr_t custom_check_for_0x22_both_actions_are_executed(
    const struct uds_context *const context, bool *apply_action) {
  if (context->registration->type == UDS_REGISTRATION_TYPE__DATA_IDENTIFIER &&
      context->registration->data_identifier.data_id ==
          data_id_rw_duplicated1 &&
      context->event == UDS_EVT_ReadDataByIdent) {
    *apply_action = true;
  }
  return UDS_OK;
}

UDSErr_t custom_action_for_0x22_both_actions_are_executed(
    struct uds_context *const context, bool *consume_event) {
  if (context->registration->type == UDS_REGISTRATION_TYPE__DATA_IDENTIFIER &&
      context->registration->data_identifier.data_id ==
          data_id_rw_duplicated1 &&
      context->event == UDS_EVT_ReadDataByIdent) {
    *consume_event = false;
  }
  return UDS_OK;
}

ZTEST_F(lib_uds, test_0x22_read_by_id_both_actions_are_executed) {
  struct uds_instance_t *instance = fixture->instance;

  data_id_check_fn_fake.custom_fake =
      custom_check_for_0x22_both_actions_are_executed;
  data_id_action_fn_fake.custom_fake =
      custom_action_for_0x22_both_actions_are_executed;

  UDSRDBIArgs_t arg = {
    .dataId = data_id_rw_duplicated1,
    .copy = copy,
  };

  int ret = receive_event(instance, UDS_EVT_ReadDataByIdent, &arg);
  zassert_ok(ret);

  zassert_true(data_id_check_fn_fake.call_count >= 1);
  zassert_equal(data_id_action_fn_fake.call_count, 2);
}

//////////////////////7
UDSErr_t custom_check_for_0x22_returns_action_returncode(
    const struct uds_context *const context, bool *apply_action) {
  if (context->registration->type == UDS_REGISTRATION_TYPE__DATA_IDENTIFIER &&
      context->registration->data_identifier.data_id == data_id_r &&
      context->event == UDS_EVT_ReadDataByIdent) {
    *apply_action = true;
  }
  return UDS_OK;
}

UDSErr_t custom_action_for_0x22_returns_action_returncode(
    struct uds_context *const context, bool *consume_event) {
  if (context->registration->type == UDS_REGISTRATION_TYPE__DATA_IDENTIFIER &&
      context->registration->data_identifier.data_id == data_id_r &&
      context->event == UDS_EVT_ReadDataByIdent) {
    *consume_event = false;
    return UDS_NRC_SecurityAccessDenied;
  }
  return UDS_OK;
}

ZTEST_F(lib_uds, test_0x22_read_by_id_returns_action_returncode) {
  struct uds_instance_t *instance = fixture->instance;

  data_id_check_fn_fake.custom_fake =
      custom_check_for_0x22_returns_action_returncode;
  data_id_action_fn_fake.custom_fake =
      custom_action_for_0x22_returns_action_returncode;

  uint32_t data = 0x11223344;

  UDSWDBIArgs_t arg = {
    .dataId = data_id_rw,
    .data = (uint8_t *)&data,
    .len = sizeof(data),
  };

  int ret = receive_event(instance, UDS_EVT_ReadDataByIdent, &arg);
  zassert_equal(ret, UDS_NRC_SecurityAccessDenied);

  zassert_true(data_id_check_fn_fake.call_count >= 1);
  zassert_equal(data_id_action_fn_fake.call_count, 1);
}
//////////////////////7
#ifdef CONFIG_UDS_USE_DYNAMIC_REGISTRATION

#define UDS_UNIQUE_DATA_ID 0xFEEF

UDSErr_t custom_check_for_0x22_dynamic_registration(
    const struct uds_context *const context, bool *apply_action) {
  if (context->registration->type == UDS_REGISTRATION_TYPE__DATA_IDENTIFIER &&
      context->registration->data_identifier.data_id == UDS_UNIQUE_DATA_ID &&
      context->event == UDS_EVT_ReadDataByIdent) {
    test_dynamic_registration_check_invoked = true;
    *apply_action = true;
  }
  return UDS_OK;
}

UDSErr_t custom_action_for_0x22_dynamic_registration(
    struct uds_context *const context, bool *consume_event) {
  if (context->registration->type == UDS_REGISTRATION_TYPE__DATA_IDENTIFIER &&
      context->registration->data_identifier.data_id == UDS_UNIQUE_DATA_ID &&
      context->event == UDS_EVT_ReadDataByIdent) {
    consume_event = false;
    test_dynamic_registration_action_invoked = true;
  }
  return UDS_OK;
}

ZTEST_F(lib_uds, test_0x22_read_by_id_dynamic_registration) {
  struct uds_instance_t *instance = fixture->instance;

  struct uds_registration_t reg;
  reg.type = UDS_REGISTRATION_TYPE__DATA_IDENTIFIER;
  reg.data_identifier.data_id = UDS_UNIQUE_DATA_ID;
  reg.data_identifier.read.check = custom_check_for_0x22_dynamic_registration;
  reg.data_identifier.read.action = custom_action_for_0x22_dynamic_registration;
  reg.data_identifier.write.check = NULL;
  reg.data_identifier.write.action = NULL;

  uint32_t reg_id;
  int ret = instance->register_event_handler(instance, reg, &reg_id, NULL);
  zassert_ok(ret);

  UDSRDBIArgs_t arg = {
    .dataId = UDS_UNIQUE_DATA_ID,
    .copy = copy,
  };

  ret = receive_event(instance, UDS_EVT_ReadDataByIdent, &arg);
  zassert_ok(ret);

  zassert_true(test_dynamic_registration_check_invoked);
  zassert_true(test_dynamic_registration_action_invoked);
}

//////////////////////7

ZTEST_F(lib_uds,
        test_0x22_read_by_id_dynamic_registration_with_no_read_fn_smoke_test) {
  struct uds_instance_t *instance = fixture->instance;

  struct uds_registration_t reg;
  reg.type = UDS_REGISTRATION_TYPE__DATA_IDENTIFIER;
  reg.data_identifier.data_id = UDS_UNIQUE_DATA_ID;
  reg.data_identifier.read.check = NULL;
  reg.data_identifier.read.action = NULL;
  reg.data_identifier.write.check = NULL;
  reg.data_identifier.write.action = NULL;

  uint32_t reg_id;
  int ret = instance->register_event_handler(instance, reg, &reg_id, NULL);
  zassert_ok(ret);

  UDSRDBIArgs_t arg = {
    .dataId = UDS_UNIQUE_DATA_ID,
    .copy = copy,
  };

  ret = receive_event(instance, UDS_EVT_ReadDataByIdent, &arg);
  zassert_equal(ret, UDS_NRC_RequestOutOfRange);
}
//////////////////////7

#endif  // CONFIG_UDS_USE_DYNAMIC_REGISTRATION
```

## src/test_0x23_read_memory_by_address.c
```c
/*
 * Copyright (C) Frickly Systems GmbH
 * Copyright (C) MBition GmbH
 *
 * SPDX-License-Identifier: Apache-2.0
 */

#include "fixture.h"

#include <zephyr/ztest.h>

ZTEST_F(lib_uds_new, test_0x23_read_memory_by_address_null_address) {
  struct uds_new_instance_t *instance = fixture->instance;

  UDSReadMemByAddrArgs_t args = {
    .memAddr = NULL,
    .memSize = 16,
    .copy = copy,
  };

  int ret = receive_event(instance, UDS_EVT_ReadMemByAddr, &args);
  zassert_equal(ret, UDS_NRC_RequestOutOfRange);
}

ZTEST_F(lib_uds_new, test_0x23_read_memory_by_address_zero_size) {
  struct uds_new_instance_t *instance = fixture->instance;

  UDSReadMemByAddrArgs_t args = {
    .memAddr = (void *)0x10000,
    .memSize = 0,
    .copy = copy,
  };

  int ret = receive_event(instance, UDS_EVT_ReadMemByAddr, &args);
  zassert_equal(ret, UDS_NRC_RequestOutOfRange);
}

#if CONFIG_BOARD_NATIVE_SIM

ZTEST_F(lib_uds_new, test_0x23_read_memory_by_address_valid_memory) {
  struct uds_new_instance_t *instance = fixture->instance;

  const uint8_t local_buffer[16] = {0x01, 0x02, 0x03, 0x04, 0x05, 0x06,
                                    0x07, 0x08, 0x09, 0x0A, 0x0B, 0x0C,
                                    0x0D, 0x0E, 0x0F, 0x10};

  UDSReadMemByAddrArgs_t args = {
    .memAddr = local_buffer,
    .memSize = 16,
    .copy = copy,
  };

  int ret = receive_event(instance, UDS_EVT_ReadMemByAddr, &args);
  zassert_equal(ret, UDS_PositiveResponse);

  zassert_equal(copy_fake.call_count, 1);
  zassert_equal(copy_fake.arg0_val, &instance->iso14229.server);
  zassert_equal(copy_fake.arg2_val, sizeof(local_buffer));

  assert_copy_data(local_buffer, sizeof(local_buffer));
}
#endif

// We use a nucleo board with known memory layout
#if CONFIG_BOARD_NUCLEO_G474RE

// STM32G474RE memory layout (correct addresses for this MCU)
const static uintptr_t known_ram_start = 0x20000000;    // SRAM start
const static uintptr_t known_ram_end = 0x20020000;      // 128KB SRAM
const static uintptr_t known_flash_start = 0x08000000;  // Flash start
const static uintptr_t known_flash_end = 0x08080000;    // 512KB Flash

// Test cases for real hardware with known memory layout
ZTEST_F(lib_uds_new, test_0x23_read_memory_by_address_nucleo_ram_valid) {
  struct uds_new_instance_t *instance = fixture->instance;

  // Test reading from valid RAM location
  UDSReadMemByAddrArgs_t args = {
    .memAddr = (void *)known_ram_start,
    .memSize = 4,
    .copy = copy,
  };

  int ret = receive_event(instance, UDS_EVT_ReadMemByAddr, &args);
  zassert_equal(ret, UDS_PositiveResponse);

  zassert_equal(copy_fake.call_count, 1);
  zassert_equal(copy_fake.arg0_val, &instance->iso14229.server);
  zassert_equal(copy_fake.arg2_val, 4);
}

ZTEST_F(lib_uds_new, test_0x23_read_memory_by_address_nucleo_ram_boundary_end) {
  struct uds_new_instance_t *instance = fixture->instance;

  // Test reading from RAM end boundary (should be valid up to end-1)
  UDSReadMemByAddrArgs_t args = {
    .memAddr = (void *)(known_ram_end - 1),
    .memSize = 1,
    .copy = copy,
  };

  int ret = receive_event(instance, UDS_EVT_ReadMemByAddr, &args);
  zassert_equal(ret, UDS_PositiveResponse);

  zassert_equal(copy_fake.call_count, 1);
  zassert_equal(copy_fake.arg2_val, 1);
}

ZTEST_F(lib_uds_new,
        test_0x23_read_memory_by_address_nucleo_ram_out_of_bounds) {
  struct uds_new_instance_t *instance = fixture->instance;

  // Test reading after RAM end (should fail)
  UDSReadMemByAddrArgs_t args = {
    .memAddr = (void *)known_ram_end,
    .memSize = 1,
    .copy = copy,
  };

  int ret = receive_event(instance, UDS_EVT_ReadMemByAddr, &args);
  zassert_equal(ret, UDS_NRC_RequestOutOfRange);
}

ZTEST_F(lib_uds_new, test_0x23_read_memory_by_address_nucleo_flash_valid) {
  struct uds_new_instance_t *instance = fixture->instance;

  // Test reading from valid Flash location
  UDSReadMemByAddrArgs_t args = {
    .memAddr = (void *)known_flash_start,
    .memSize = 4,
    .copy = copy,
  };

  int ret = receive_event(instance, UDS_EVT_ReadMemByAddr, &args);
  zassert_equal(ret, UDS_PositiveResponse);

  zassert_equal(copy_fake.call_count, 1);
  zassert_equal(copy_fake.arg0_val, &instance->iso14229.server);
  zassert_equal(copy_fake.arg2_val, 4);
}

ZTEST_F(lib_uds_new,
        test_0x23_read_memory_by_address_nucleo_flash_boundary_end) {
  struct uds_new_instance_t *instance = fixture->instance;

  // Test reading from Flash end boundary (should be valid up to end-1)
  UDSReadMemByAddrArgs_t args = {
    .memAddr = (void *)(known_flash_end - 1),
    .memSize = 1,
    .copy = copy,
  };

  int ret = receive_event(instance, UDS_EVT_ReadMemByAddr, &args);
  zassert_equal(ret, UDS_PositiveResponse);

  zassert_equal(copy_fake.call_count, 1);
  zassert_equal(copy_fake.arg2_val, 1);
}

ZTEST_F(lib_uds_new,
        test_0x23_read_memory_by_address_nucleo_flash_out_of_bounds) {
  struct uds_new_instance_t *instance = fixture->instance;

  // Test reading after Flash end (should fail)
  UDSReadMemByAddrArgs_t args = {
    .memAddr = (void *)known_flash_end,
    .memSize = 1,
    .copy = copy,
  };

  int ret = receive_event(instance, UDS_EVT_ReadMemByAddr, &args);
  zassert_equal(ret, UDS_NRC_RequestOutOfRange);
}

ZTEST_F(lib_uds_new,
        test_0x23_read_memory_by_address_nucleo_invalid_peripheral) {
  struct uds_new_instance_t *instance = fixture->instance;

  // Test reading from peripheral region (should fail as not RAM/Flash)
  UDSReadMemByAddrArgs_t args = {
    .memAddr = (void *)0x40000000,  // GPIO peripheral base
    .memSize = 4,
    .copy = copy,
  };

  int ret = receive_event(instance, UDS_EVT_ReadMemByAddr, &args);
  zassert_equal(ret, UDS_NRC_RequestOutOfRange);
}

ZTEST_F(lib_uds_new,
        test_0x23_read_memory_by_address_nucleo_invalid_low_memory) {
  struct uds_new_instance_t *instance = fixture->instance;

  // Test reading from invalid low memory region
  UDSReadMemByAddrArgs_t args = {
    .memAddr = (void *)0x00001000,  // Below Flash region
    .memSize = 4,
    .copy = copy,
  };

  int ret = receive_event(instance, UDS_EVT_ReadMemByAddr, &args);
  zassert_equal(ret, UDS_NRC_RequestOutOfRange);
}

ZTEST_F(lib_uds_new, test_0x23_read_memory_by_address_nucleo_ram_overflow) {
  struct uds_new_instance_t *instance = fixture->instance;

  // Test reading that would overflow past RAM end
  UDSReadMemByAddrArgs_t args = {
    .memAddr = (void *)(known_ram_end - 2),
    .memSize = 4,  // Would read 2 bytes past end
    .copy = copy,
  };

  int ret = receive_event(instance, UDS_EVT_ReadMemByAddr, &args);
  zassert_equal(ret, UDS_NRC_RequestOutOfRange);
}

ZTEST_F(lib_uds_new, test_0x23_read_memory_by_address_nucleo_flash_overflow) {
  struct uds_new_instance_t *instance = fixture->instance;

  // Test reading that would overflow past Flash end
  UDSReadMemByAddrArgs_t args = {
    .memAddr = (void *)(known_flash_end - 2),
    .memSize = 4,  // Would read 2 bytes past end
    .copy = copy,
  };

  int ret = receive_event(instance, UDS_EVT_ReadMemByAddr, &args);
  zassert_equal(ret, UDS_NRC_RequestOutOfRange);
}

ZTEST_F(lib_uds_new, test_0x23_read_memory_by_address_nucleo_large_read_ram) {
  struct uds_new_instance_t *instance = fixture->instance;

  // Test reading large amount from RAM (1KB)
  UDSReadMemByAddrArgs_t args = {
    .memAddr = (void *)known_ram_start,
    .memSize = 1024,
    .copy = copy,
  };

  int ret = receive_event(instance, UDS_EVT_ReadMemByAddr, &args);
  zassert_equal(ret, UDS_PositiveResponse);

  zassert_equal(copy_fake.call_count, 1);
  zassert_equal(copy_fake.arg2_val, 1024);
}

ZTEST_F(lib_uds_new, test_0x23_read_memory_by_address_nucleo_large_read_flash) {
  struct uds_new_instance_t *instance = fixture->instance;

  // Test reading large amount from Flash (1KB)
  UDSReadMemByAddrArgs_t args = {
    .memAddr = (void *)known_flash_start,
    .memSize = 1024,
    .copy = copy,
  };

  int ret = receive_event(instance, UDS_EVT_ReadMemByAddr, &args);
  zassert_equal(ret, UDS_PositiveResponse);

  zassert_equal(copy_fake.call_count, 1);
  zassert_equal(copy_fake.arg2_val, 1024);
}

ZTEST_F(lib_uds_new, test_0x23_read_memory_by_address_nucleo_before_ram) {
  struct uds_new_instance_t *instance = fixture->instance;

  // Test reading just before RAM
  UDSReadMemByAddrArgs_t args = {
    .memAddr = (void *)(known_ram_start - 1),
    .memSize = 4,  // overlapping
    .copy = copy,
  };

  int ret = receive_event(instance, UDS_EVT_ReadMemByAddr, &args);
  zassert_equal(ret, UDS_NRC_RequestOutOfRange);
}

ZTEST_F(lib_uds_new, test_0x23_read_memory_by_address_nucleo_before_flash) {
  struct uds_new_instance_t *instance = fixture->instance;

  // Test reading just before Flash
  UDSReadMemByAddrArgs_t args = {
    .memAddr = (void *)(known_flash_start - 1),
    .memSize = 4,  // overlapping
    .copy = copy,
  };

  int ret = receive_event(instance, UDS_EVT_ReadMemByAddr, &args);
  zassert_equal(ret, UDS_NRC_RequestOutOfRange);
}

#endif
```

## src/test_0x29_auth.c
```c
/*
 * Copyright (C) Frickly Systems GmbH
 * Copyright (C) MBition GmbH
 *
 * SPDX-License-Identifier: Apache-2.0
 */

#include "ardep/uds.h"
#include "fixture.h"
#include "iso14229.h"
#include "zephyr/ztest_assert.h"

#include <zephyr/ztest.h>

UDSErr_t auth_0x29_check_fn(const struct uds_context *const context,
                            bool *apply_action) {
  if (context->event == UDS_EVT_Auth) {
    UDSAuthArgs_t *args = (UDSAuthArgs_t *)context->arg;

    switch (args->type) {
      case UDS_LEV_AT_VCU:
      case UDS_LEV_AT_AC:
        *apply_action = true;
        return UDS_OK;
    }
  } else if (context->event == UDS_EVT_AuthTimeout) {
    *apply_action = true;
    return UDS_OK;
  }
  return UDS_NRC_SubFunctionNotSupported;
}

UDSErr_t auth_0x29_action_fn(struct uds_context *const context,
                             bool *consume_event) {
  if (context->event == UDS_EVT_Auth) {
    UDSAuthArgs_t *args = (UDSAuthArgs_t *)context->arg;
    *consume_event = true;
    switch (args->type) {
      case UDS_LEV_AT_AC:
        return args->set_auth_state(context->server, UDS_AT_ACAPCE);
      case UDS_LEV_AT_VCU:

        // return args->set_auth_state(context->server, UDS_AT_VCU);
      default:
        return UDS_NRC_SubFunctionNotSupported;
    }

    return UDS_PositiveResponse;
  } else if (context->event == UDS_EVT_AuthTimeout) {
    return UDS_PositiveResponse;
  }
  return UDS_NRC_SubFunctionNotSupported;
}

// ZTEST_F(lib_uds, test_0x29_auth_timeout) {
//   struct uds_instance_t *instance = fixture->instance;

//   data_id_check_fn_fake.custom_fake = auth_0x29_check_fn;
//   data_id_action_fn_fake.custom_fake = auth_0x29_action_fn;

//   int ret = receive_event(instance, UDS_EVT_AuthTimeout, NULL);
//   zassert_ok(ret);

//   assert_auth_state(UDS_AT_ACAPCE);
// }

ZTEST_F(lib_uds, test_0x29_auth) {
  struct uds_instance_t *instance = fixture->instance;

  data_id_check_fn_fake.custom_fake = auth_0x29_check_fn;
  data_id_action_fn_fake.custom_fake = auth_0x29_action_fn;

  UDSAuthArgs_t args = {
    .type = UDS_LEV_AT_AC,
    .copy = copy,
    .set_auth_state = set_auth_state,
  };

  uint32_t action_call_count = data_id_action_fn_fake.call_count;

  int ret = receive_event(instance, UDS_EVT_Auth, &args);
  zassert_ok(ret);
  zassert_equal(set_auth_state_fake.call_count, 1);
  zassert_true(action_call_count < data_id_action_fn_fake.call_count);

  uint8_t certificate[] = {0x00, 0x11, 0x22, 0x33};
  uint8_t challenge[] = {0x44, 0x55, 0x66, 0x77, 0x88};
  args.type = UDS_LEV_AT_VCU;
  args.subFuncArgs.verifyCertArgs.cert = certificate;
  args.subFuncArgs.verifyCertArgs.certLen = sizeof(certificate);
  args.subFuncArgs.verifyCertArgs.challenge = challenge;
  args.subFuncArgs.verifyCertArgs.challengeLen = sizeof(challenge);

  assert_auth_state(UDS_AT_ACAPCE);
}
```

## src/test_0x3D_write_memory_by_address.c
```c
/*
 * Copyright (C) Frickly Systems GmbH
 * Copyright (C) MBition GmbH
 *
 * SPDX-License-Identifier: Apache-2.0
 */

#include "fixture.h"

#include <zephyr/ztest.h>

ZTEST_F(lib_uds_new, test_0x3D_write_memory_by_address_null_address) {
  struct uds_new_instance_t *instance = fixture->instance;

  const uint8_t data[4] = {0xAA, 0xBB, 0xCC, 0xDD};

  UDSWriteMemByAddrArgs_t args = {
    .memAddr = NULL,
    .memSize = sizeof(data),
    .data = data,
  };

  int ret = receive_event(instance, UDS_EVT_WriteMemByAddr, &args);
  zassert_equal(ret, UDS_NRC_RequestOutOfRange);
}

ZTEST_F(lib_uds_new, test_0x3D_write_memory_by_address_zero_size) {
  struct uds_new_instance_t *instance = fixture->instance;

  uint8_t dest[8] = {0};
  const uint8_t data[1] = {0x11};

  UDSWriteMemByAddrArgs_t args = {
    .memAddr = dest,
    .memSize = 0,
    .data = data,
  };

  int ret = receive_event(instance, UDS_EVT_WriteMemByAddr, &args);
  zassert_equal(ret, UDS_NRC_RequestOutOfRange);
}

#if CONFIG_BOARD_NATIVE_SIM

ZTEST_F(lib_uds_new, test_0x3D_write_memory_by_address_valid_memory) {
  struct uds_new_instance_t *instance = fixture->instance;

  uint8_t dest[16] = {0};
  const uint8_t src[16] = {0x01, 0x02, 0x03, 0x04, 0x05, 0x06, 0x07, 0x08,
                           0x09, 0x0A, 0x0B, 0x0C, 0x0D, 0x0E, 0x0F, 0x10};

  UDSWriteMemByAddrArgs_t args = {
    .memAddr = dest,
    .memSize = sizeof(src),
    .data = src,
  };

  int ret = receive_event(instance, UDS_EVT_WriteMemByAddr, &args);
  zassert_equal(ret, UDS_PositiveResponse);

  zassert_mem_equal(dest, src, sizeof(src));
}

ZTEST_F(lib_uds_new, test_0x3D_write_memory_by_address_large_buffer) {
  struct uds_new_instance_t *instance = fixture->instance;

  uint8_t dest[2096] = {0};
  uint8_t src[2096];

  // Fill source buffer with pattern
  for (size_t i = 0; i < sizeof(src); ++i) {
    src[i] = (uint8_t)(i % 256);
  }

  UDSWriteMemByAddrArgs_t args = {
    .memAddr = dest,
    .memSize = sizeof(src),
    .data = src,
  };

  int ret = receive_event(instance, UDS_EVT_WriteMemByAddr, &args);
  zassert_equal(ret, UDS_PositiveResponse);

  zassert_mem_equal(dest, src, sizeof(src));
}

#endif

// We use a nucleo board with known memory layout
#if CONFIG_BOARD_NUCLEO_G474RE

// STM32G474RE memory layout (correct addresses for this MCU)
const static uintptr_t known_ram_start = 0x20000000;    // SRAM start
const static uintptr_t known_ram_end = 0x20020000;      // 128KB SRAM
const static uintptr_t known_flash_start = 0x08000000;  // Flash start
const static uintptr_t known_flash_end = 0x08080000;    // 512KB Flash

ZTEST_F(lib_uds_new, test_0x3D_write_memory_by_address_nucleo_ram_valid) {
  struct uds_new_instance_t *instance = fixture->instance;

  // Use a local buffer within RAM for a safe write
  uint8_t dest[8] = {0};
  const uint8_t src[8] = {0xDE, 0xAD, 0xBE, 0xEF, 0xFE, 0xED, 0xBA, 0xBE};

  UDSWriteMemByAddrArgs_t args = {
    .memAddr = dest,
    .memSize = sizeof(src),
    .data = src,
  };

  int ret = receive_event(instance, UDS_EVT_WriteMemByAddr, &args);
  zassert_equal(ret, UDS_PositiveResponse);
  zassert_mem_equal(dest, src, sizeof(src));
}

ZTEST_F(lib_uds_new,
        test_0x3D_write_memory_by_address_nucleo_ram_out_of_bounds) {
  struct uds_new_instance_t *instance = fixture->instance;

  // Writing after RAM end (should fail before attempting to write)
  const uint8_t src[1] = {0x11};
  UDSWriteMemByAddrArgs_t args = {
    .memAddr = (void *)known_ram_end,
    .memSize = 1,
    .data = src,
  };

  int ret = receive_event(instance, UDS_EVT_WriteMemByAddr, &args);
  zassert_equal(ret, UDS_NRC_RequestOutOfRange);
}

ZTEST_F(lib_uds_new,
        test_0x3D_write_memory_by_address_nucleo_flash_not_writeable) {
  struct uds_new_instance_t *instance = fixture->instance;

  // Any Flash write should be rejected in implementation
  const uint8_t src4[4] = {1, 2, 3, 4};
  UDSWriteMemByAddrArgs_t args1 = {
    .memAddr = (void *)known_flash_start,
    .memSize = 4,
    .data = src4,
  };

  int ret1 = receive_event(instance, UDS_EVT_WriteMemByAddr, &args1);
  zassert_equal(ret1, UDS_NRC_RequestOutOfRange);

  UDSWriteMemByAddrArgs_t args2 = {
    .memAddr = (void *)(known_flash_end - 1),
    .memSize = 1,
    .data = src4,
  };

  int ret2 = receive_event(instance, UDS_EVT_WriteMemByAddr, &args2);
  zassert_equal(ret2, UDS_NRC_RequestOutOfRange);
}

ZTEST_F(lib_uds_new,
        test_0x3D_write_memory_by_address_nucleo_flash_out_of_bounds) {
  struct uds_new_instance_t *instance = fixture->instance;

  const uint8_t src[1] = {0x22};
  UDSWriteMemByAddrArgs_t args = {
    .memAddr = (void *)known_flash_end,
    .memSize = 1,
    .data = src,
  };

  int ret = receive_event(instance, UDS_EVT_WriteMemByAddr, &args);
  zassert_equal(ret, UDS_NRC_RequestOutOfRange);
}

ZTEST_F(lib_uds_new,
        test_0x3D_write_memory_by_address_nucleo_invalid_peripheral) {
  struct uds_new_instance_t *instance = fixture->instance;

  const uint8_t src[4] = {0, 0, 0, 0};
  UDSWriteMemByAddrArgs_t args = {
    .memAddr = (void *)0x40000000,  // GPIO peripheral base
    .memSize = 4,
    .data = src,
  };

  int ret = receive_event(instance, UDS_EVT_WriteMemByAddr, &args);
  zassert_equal(ret, UDS_NRC_RequestOutOfRange);
}

ZTEST_F(lib_uds_new,
        test_0x3D_write_memory_by_address_nucleo_invalid_low_memory) {
  struct uds_new_instance_t *instance = fixture->instance;

  const uint8_t src[4] = {0};
  UDSWriteMemByAddrArgs_t args = {
    .memAddr = (void *)0x00001000,  // Below Flash region
    .memSize = 4,
    .data = src,
  };

  int ret = receive_event(instance, UDS_EVT_WriteMemByAddr, &args);
  zassert_equal(ret, UDS_NRC_RequestOutOfRange);
}

ZTEST_F(lib_uds_new, test_0x3D_write_memory_by_address_nucleo_large_write_ram) {
  struct uds_new_instance_t *instance = fixture->instance;

  // Large write to a local RAM buffer
  uint8_t dest[1024] = {0};
  uint8_t src[1024];
  for (size_t i = 0; i < sizeof(src); ++i) src[i] = (uint8_t)i;

  UDSWriteMemByAddrArgs_t args = {
    .memAddr = dest,
    .memSize = sizeof(src),
    .data = src,
  };

  int ret = receive_event(instance, UDS_EVT_WriteMemByAddr, &args);
  zassert_equal(ret, UDS_PositiveResponse);
  zassert_mem_equal(dest, src, sizeof(src));
}

ZTEST_F(lib_uds_new, test_0x3D_write_memory_by_address_nucleo_before_ram) {
  struct uds_new_instance_t *instance = fixture->instance;

  const uint8_t src[4] = {0};
  UDSWriteMemByAddrArgs_t args = {
    .memAddr = (void *)(known_ram_start - 1),
    .memSize = 4,  // overlapping into RAM
    .data = src,
  };

  int ret = receive_event(instance, UDS_EVT_WriteMemByAddr, &args);
  zassert_equal(ret, UDS_NRC_RequestOutOfRange);
}

ZTEST_F(lib_uds_new, test_0x3D_write_memory_by_address_nucleo_before_flash) {
  struct uds_new_instance_t *instance = fixture->instance;

  const uint8_t src[4] = {0};
  UDSWriteMemByAddrArgs_t args = {
    .memAddr = (void *)(known_flash_start - 1),
    .memSize = 4,  // overlapping into Flash
    .data = src,
  };

  int ret = receive_event(instance, UDS_EVT_WriteMemByAddr, &args);
  zassert_equal(ret, UDS_NRC_RequestOutOfRange);
}

#endif
```
