## CMakeLists.txt
```
# SPDX-License-Identifier: Apache-2.0

cmake_minimum_required(VERSION 3.20.0)

find_package(Zephyr REQUIRED HINTS $ENV{ZEPHYR_BASE})

project(test_uds_frickly)

FILE(GLOB app_sources src/*.c)
target_sources(app PRIVATE ${app_sources})
```

## prj.conf
```kconfig
CONFIG_ZTEST=y
CONFIG_ASSERT=y
CONFIG_CAN_FAKE=y
CONFIG_CAN=y
CONFIG_CAN_MAX_FILTER=12

CONFIG_ISOTP=n
CONFIG_UDS=n

CONFIG_LOG=y
CONFIG_LOG_INFO_COLOR_GREEN=y

CONFIG_UDS_FRICKLY=y

# Enable heap allocation for k_malloc
CONFIG_HEAP_MEM_POOL_SIZE=1024
CONFIG_STD_C11=y
```

## src/main.c
```c
/*
 * Copyright (c) 2023 Intel Corporation
 *
 * SPDX-License-Identifier: Apache-2.0
 */

#include "fixture.h"
#include "zephyr/ztest_assert.h"

#include <zephyr/fff.h>
#include <zephyr/ztest.h>

#include <ardep/uds_frickly.h>

ZTEST_F(lib_uds_frickly, test_0x11_ecu_reset) {
  struct uds_service* service = fixture->service;

  UDSDiagSessCtrlArgs_t args = {
    .type = 0x01,
    .p2_ms = 100,
    .p2_star_ms = 5000,
  };
  int ret = receive_event(service, UDS_EVT_DiagSessCtrl, &args);
  zassert_ok(ret);

  zassert_equal(service->state.session_type, 0x01);
}
```

## src/fixture.c
```c
/**
 * Copyright (c) Frickly Systems GmbH
 *
 * SPDX-License-Identifier: Apache-2.0
 */

#include "fixture.h"

#include <string.h>

#include <zephyr/drivers/can.h>
#include <zephyr/drivers/can/can_fake.h>
#include <zephyr/ztest.h>

#include <ardep/iso14229.h>

DEFINE_FFF_GLOBALS;

static const UDSISOTpCConfig_t cfg = {
  // Hardware Addresses
  .source_addr = 0x7E8,  // Can ID Server (us)
  .target_addr = 0x7E0,  // Can ID Client (them)

  // Functional Addresses
  .source_addr_func = 0x7DF,             // ID Server (us)
  .target_addr_func = UDS_TP_NOOP_ADDR,  // ID Client (them)
};

static void *uds_frickly_setup(void) {
  static struct lib_uds_frickly_fixture fixture = {
    .cfg = cfg,
    .can_dev = DEVICE_DT_GET(DT_CHOSEN(zephyr_canbus)),
  };

  return &fixture;
}

ARDEP_UDS_SERVICE_DEFINE(
    test_service,
    ARDEP_UDS_SERVICE_CAN_DEFINE(DEVICE_DT_GET(DT_CHOSEN(zephyr_canbus)),
                                 CAN_MODE_NORMAL,
                                 cfg));

#ARDEP_UPDS_SERVICE_STATIC_DATA_BY_ID_DEFINE(id)

static void uds_frickly_before(void *f) {
  struct lib_uds_frickly_fixture *fixture = f;
  fixture->service = ardep_uds_service_get_by_id("test_service");
  struct uds_service *service = fixture->service;

  FFF_RESET_HISTORY();

  int ret = ardep_uds_service_init(service, f);
  assert(ret == 0);

  ret = ardep_uds_service_start(service);
  assert(ret == 0);
}

typedef UDSErr_t (*uds_callback)(struct iso14229_zephyr_instance *inst,
                                 UDSEvent_t event,
                                 void *arg,
                                 void *user_context);

UDSErr_t receive_event(struct uds_service *service,
                       UDSEvent_t event,
                       void *args) {
  return service->iso14229.event_callback(&service->iso14229, event, args,
                                          service);
}

ZTEST_SUITE(
    lib_uds_frickly, NULL, uds_frickly_setup, uds_frickly_before, NULL, NULL);
```

## src/fixture.h
```c
#ifndef APP_TESTS_LIB_ISO14229_SRC_FIXTURE_H_
#define APP_TESTS_LIB_ISO14229_SRC_FIXTURE_H_

#include "ardep/uds_frickly.h"

#include <zephyr/drivers/can.h>
#include <zephyr/drivers/can/can_fake.h>
#include <zephyr/fff.h>

#include <ardep/iso14229.h>
#include <iso14229.h>

struct lib_uds_frickly_fixture {
  struct uds_service *service;

  UDSISOTpCConfig_t cfg;
  const struct device *can_dev;
};

/**
 * @brief Receive an event from iso14229
 */
UDSErr_t receive_event(struct uds_service *service,
                       UDSEvent_t event,
                       void *args);

#endif  // APP_TESTS_LIB_ISO14229_SRC_FIXTURE_H_
```
