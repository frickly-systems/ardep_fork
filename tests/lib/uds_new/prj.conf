## prj.conf
```kconfig
CONFIG_ZTEST=y
CONFIG_ASSERT=y
CONFIG_CAN_FAKE=y
CONFIG_CAN=y
CONFIG_CAN_MAX_FILTER=12

CONFIG_ISOTP=n
CONFIG_UDS=n

CONFIG_LOG=y
CONFIG_LOG_INFO_COLOR_GREEN=y

CONFIG_UDS_NEW=y
CONFIG_UDS_USE_DYNAMIC_REGISTRATION=y

# Enable heap allocation for k_malloc
CONFIG_HEAP_MEM_POOL_SIZE=1024
CONFIG_STD_C11=y
```

## src/main.c
```c
/**
 * Copyright (c) Frickly Systems GmbH
 *
 * SPDX-License-Identifier: Apache-2.0
 */

#include <zephyr/fff.h>
#include <zephyr/ztest.h>

#include <ardep/uds_new.h>
```

## src/fixture.c
```c
/*
 * Copyright (C) Frickly Systems GmbH
 * Copyright (C) MBition GmbH
 *
 * SPDX-License-Identifier: Apache-2.0
 */

#include "ardep/uds_new.h"
#include "fixture.h"

#include <string.h>

#include <zephyr/drivers/can.h>
#include <zephyr/drivers/can/can_fake.h>
#include <zephyr/ztest.h>

#include <iso14229.h>

DEFINE_FFF_GLOBALS;

DEFINE_FAKE_VALUE_FUNC(uint8_t, copy, UDSServer_t *, const void *, uint16_t);

DEFINE_FAKE_VALUE_FUNC(UDSErr_t,
                       data_id_check_fn,
                       const struct uds_new_context *const,
                       bool *);

DEFINE_FAKE_VALUE_FUNC(UDSErr_t,
                       data_id_action_fn,
                       struct uds_new_context *const,
                       bool *);

#define FFF_FAKES_LIST(FAKE) \
  FAKE(copy)                 \
  FAKE(data_id_check_fn)     \
  FAKE(data_id_action_fn)

struct uds_new_instance_t fixture_uds_instance;

#ifdef CONFIG_UDS_USE_DYNAMIC_REGISTRATION
bool test_dynamic_registration_check_invoked;
bool test_dynamic_registration_action_invoked;
#endif  // # CONFIG_UDS_USE_DYNAMIC_REGISTRATION

const uint16_t data_id_r = 1;
uint8_t data_id_r_data[4];

const uint16_t data_id_rw = 2;
uint8_t data_id_rw_data[4];

const uint16_t data_id_rw_duplicated1 = 3;
const uint16_t data_id_rw_duplicated2 = 3;
uint8_t data_id_rw_duplicated_data[4];

UDS_NEW_REGISTER_DATA_IDENTIFIER_STATIC(&fixture_uds_instance,
                                        data_id_r,
                                        data_id_r_data,
                                        // read
                                        data_id_check_fn,
                                        data_id_action_fn,
                                        // write
                                        NULL,
                                        NULL,
                                        NULL)

UDS_NEW_REGISTER_DATA_IDENTIFIER_STATIC(&fixture_uds_instance,
                                        data_id_rw,
                                        data_id_rw_data,
                                        // read
                                        data_id_check_fn,
                                        data_id_action_fn,
                                        // write
                                        data_id_check_fn,
                                        data_id_action_fn,
                                        NULL)

// Duplicated Registratin for the same data ID
UDS_NEW_REGISTER_DATA_IDENTIFIER_STATIC(&fixture_uds_instance,
                                        data_id_rw_duplicated1,
                                        data_id_rw_duplicated_data,
                                        // read
                                        data_id_check_fn,
                                        data_id_action_fn,
                                        // write
                                        data_id_check_fn,
                                        data_id_action_fn,
                                        NULL)

UDS_NEW_REGISTER_DATA_IDENTIFIER_STATIC(&fixture_uds_instance,
                                        data_id_rw_duplicated2,
                                        data_id_rw_duplicated_data,
                                        // read
                                        data_id_check_fn,
                                        data_id_action_fn,
                                        // write
                                        data_id_check_fn,
                                        data_id_action_fn,
                                        NULL)

UDS_NEW_REGISTER_ECU_RESET_HANDLER(&fixture_uds_instance,
                                   NULL,
                                   ECU_RESET__KEY_OFF_ON,
                                   // ecu_reset
                                   data_id_check_fn,
                                   data_id_action_fn,
                                   // do_scheduled_reset
                                   data_id_check_fn,
                                   data_id_action_fn)

UDS_NEW_REGISTER_MEMORY_DEFAULT_HANDLER(&fixture_uds_instance)

UDS_NEW_REGISTER_READ_DTC_INFO_HANDLER_ALL(&fixture_uds_instance,
                                           NULL,
                                           data_id_check_fn,
                                           data_id_action_fn)

static const UDSISOTpCConfig_t default_cfg = {
  // Hardware Addresses
  .source_addr = 0x7E8,  // Can ID Server (us)
  .target_addr = 0x7E0,  // Can ID Client (them)

  // Functional Addresses
  .source_addr_func = 0x7DF,             // ID Server (us)
  .target_addr_func = UDS_TP_NOOP_ADDR,  // ID Client (them)
};

static uint8_t copied_data[4096];
static uint32_t copied_len;

void assert_copy_data(const uint8_t *data, uint32_t len) {
  zassert_equal(copied_len, len, "Expected length %u, but got %u", len,
                copied_len);
  zassert_mem_equal(copied_data, data, len);
}

UDSErr_t receive_event(struct uds_new_instance_t *inst,
                       UDSEvent_t event,
                       void *args) {
  return inst->iso14229.event_callback(&inst->iso14229, event, args, inst);
}

static uint8_t custom_copy(UDSServer_t *server,
                           const void *data,
                           uint16_t len) {
  copied_len = len;
  memcpy(copied_data, data, len);

  return 0;
}

static void *uds_new_setup(void) {
  memset(&fixture_uds_instance, 0, sizeof(fixture_uds_instance));

  static struct lib_uds_new_fixture fixture = {
    .cfg = default_cfg,
    .can_dev = DEVICE_DT_GET(DT_CHOSEN(zephyr_canbus)),
    .instance = &fixture_uds_instance,
  };

  printk("Using CAN device %s\n", fixture.can_dev->name);

  return &fixture;
}

static void uds_new_before(void *f) {
  struct lib_uds_new_fixture *fixture = f;
  const struct device *dev = fixture->can_dev;
  struct uds_new_instance_t *uds_instance = fixture->instance;

  FFF_FAKES_LIST(RESET_FAKE);
  FFF_RESET_HISTORY();

  copy_fake.custom_fake = custom_copy;

  int ret = uds_new_init(uds_instance, &default_cfg, dev, fixture);
  assert(ret == 0);

  STRUCT_SECTION_FOREACH (uds_new_registration_t, reg) {
  }

  test_dynamic_registration_check_invoked = false;
  test_dynamic_registration_action_invoked = false;

  memset(copied_data, 0, sizeof(copied_data));
  copied_len = 0;
}

static void uds_new_after(void *f) {
  struct lib_uds_new_fixture *fixture = f;

#ifdef CONFIG_UDS_USE_DYNAMIC_REGISTRATION
  struct uds_new_registration_t *next =
      fixture->instance->dynamic_registrations;

  // Free all dynamically registered event handler
  while (next != NULL) {
    struct uds_new_registration_t *current = next;
    next = current->next;
    k_free(current);
  }

  fixture->instance->dynamic_registrations = NULL;
#endif
}

ZTEST_SUITE(
    lib_uds_new, NULL, uds_new_setup, uds_new_before, uds_new_after, NULL);
```

## src/fixture.h
```c
/*
 * Copyright (C) Frickly Systems GmbH
 * Copyright (C) MBition GmbH
 *
 * SPDX-License-Identifier: Apache-2.0
 */
#ifndef APP_TESTS_LIB_ISO14229_SRC_FIXTURE_H_
#define APP_TESTS_LIB_ISO14229_SRC_FIXTURE_H_

#include "ardep/uds_new.h"

#include <zephyr/drivers/can.h>
#include <zephyr/drivers/can/can_fake.h>
#include <zephyr/fff.h>

#include <ardep/iso14229.h>
#include <iso14229.h>

DECLARE_FAKE_VALUE_FUNC(uint8_t, copy, UDSServer_t *, const void *, uint16_t);

DECLARE_FAKE_VALUE_FUNC(UDSErr_t,
                        data_id_check_fn,
                        const struct uds_new_context *const,
                        bool *);

DECLARE_FAKE_VALUE_FUNC(UDSErr_t,
                        data_id_action_fn,
                        struct uds_new_context *const,
                        bool *);

extern const uint16_t data_id_r;
extern uint8_t data_id_r_data[4];

extern const uint16_t data_id_rw;
extern uint8_t data_id_rw_data[4];

extern const uint16_t data_id_rw_duplicated1;
extern const uint16_t data_id_rw_duplicated2;
extern uint8_t data_id_rw_duplicated_data[4];

#ifdef CONFIG_UDS_USE_DYNAMIC_REGISTRATION
extern bool test_dynamic_registration_check_invoked;
extern bool test_dynamic_registration_action_invoked;
#endif  // # CONFIG_UDS_USE_DYNAMIC_REGISTRATION

struct lib_uds_new_fixture {
  UDSISOTpCConfig_t cfg;
  struct uds_new_instance_t *instance;
  const struct device *can_dev;
};

/**
 * @brief Receive an event from iso14229
 */
UDSErr_t receive_event(struct uds_new_instance_t *inst,
                       UDSEvent_t event,
                       void *args);

/**
 * @brief Assert that the copied data matches the expected data.
 *
 * Beware that the data is in big endian!
 */
void assert_copy_data(const uint8_t *data, uint32_t len);

#endif  // APP_TESTS_LIB_ISO14229_SRC_FIXTURE_H_
```

## src/test_0x11_ecu_reset.c
```c
#include "fixture.h"
#include "iso14229.h"
#include "zephyr/ztest_assert.h"

#include <zephyr/fff.h>
#include <zephyr/ztest.h>

#include <ardep/uds_new.h>

UDSErr_t custom_check_for_0x11_return_subfunc_not_sup(
    const struct uds_new_context *const context, bool *apply_action) {
  if (context->registration->type == UDS_NEW_REGISTRATION_TYPE__ECU_RESET &&
      context->event == UDS_EVT_EcuReset) {
    UDSECUResetArgs_t *args = context->arg;
    if (args->type == ECU_RESET_KEY_OFF_ON) {
      *apply_action = true;
    }
  }
  return UDS_OK;
}

UDSErr_t custom_action_for_0x11_return_subfunc_not_sup(
    struct uds_new_context *const context, bool *consume_event) {
  if (context->registration->type == UDS_NEW_REGISTRATION_TYPE__ECU_RESET &&
      context->event == UDS_EVT_EcuReset) {
    UDSECUResetArgs_t *args = context->arg;
    if (args->type == ECU_RESET_KEY_OFF_ON) {
      *consume_event = true;
    }
  }
  return UDS_OK;
}

ZTEST_F(lib_uds_new, test_0x11_ecu_reset_return_subfunc_not_sup) {
  struct uds_new_instance_t *instance = fixture->instance;

  data_id_check_fn_fake.custom_fake =
      custom_check_for_0x11_return_subfunc_not_sup;
  data_id_action_fn_fake.custom_fake =
      custom_action_for_0x11_return_subfunc_not_sup;

  UDSECUResetArgs_t arg = {
    .type = ECU_RESET_HARD,
    .powerDownTimeMillis = 500,
  };

  int ret = receive_event(instance, UDS_EVT_EcuReset, &arg);
  zassert_equal(ret, UDS_NRC_SubFunctionNotSupported);
}
```

## src/test_0x22_read_data_by_id.c
```c
/*
 * Copyright (C) Frickly Systems GmbH
 * Copyright (C) MBition GmbH
 *
 * SPDX-License-Identifier: Apache-2.0
 */
#include "fixture.h"
#include "iso14229.h"
#include "zephyr/ztest_assert.h"

#include <zephyr/fff.h>
#include <zephyr/ztest.h>

#include <ardep/uds_new.h>

ZTEST_F(lib_uds_new, test_0x22_read_by_id_fails_when_no_action_applies) {
  struct uds_new_instance_t *instance = fixture->instance;

  UDSRDBIArgs_t arg = {
    .dataId = data_id_r,
    .copy = copy,
  };

  int ret = receive_event(instance, UDS_EVT_ReadDataByIdent, &arg);
  zassert_equal(ret, UDS_NRC_RequestOutOfRange);
  zassert_true(data_id_check_fn_fake.call_count >= 1);
  zassert_equal(data_id_action_fn_fake.call_count, 0);
}

//////////////////////7

UDSErr_t custom_check_for_0x22_applies_action_when_check_succeeds(
    const struct uds_new_context *const context, bool *apply_action) {
  if (context->registration->type ==
          UDS_NEW_REGISTRATION_TYPE__DATA_IDENTIFIER &&
      context->registration->data_identifier.data_id == data_id_r &&
      context->event == UDS_EVT_ReadDataByIdent) {
    *apply_action = true;
  }
  return UDS_OK;
}

ZTEST_F(lib_uds_new, test_0x22_read_by_id_applies_action_when_check_succeeds) {
  struct uds_new_instance_t *instance = fixture->instance;

  data_id_check_fn_fake.custom_fake =
      custom_check_for_0x22_applies_action_when_check_succeeds;

  UDSRDBIArgs_t arg = {
    .dataId = data_id_r,
    .copy = copy,
  };

  int ret = receive_event(instance, UDS_EVT_ReadDataByIdent, &arg);
  zassert_ok(ret);

  zassert_true(data_id_check_fn_fake.call_count >= 1);
  zassert_equal(data_id_action_fn_fake.call_count, 1);
}

//////////////////////7

UDSErr_t custom_check_for_0x22_consume_event_by_default_on_action(
    const struct uds_new_context *const context, bool *apply_action) {
  if (context->registration->type ==
          UDS_NEW_REGISTRATION_TYPE__DATA_IDENTIFIER &&
      context->registration->data_identifier.data_id ==
          data_id_rw_duplicated1 &&
      context->event == UDS_EVT_ReadDataByIdent) {
    *apply_action = true;
  }
  return UDS_OK;
}

ZTEST_F(lib_uds_new, test_0x22_read_by_id_consume_event_by_default_on_action) {
  struct uds_new_instance_t *instance = fixture->instance;

  data_id_check_fn_fake.custom_fake =
      custom_check_for_0x22_consume_event_by_default_on_action;

  UDSRDBIArgs_t arg = {
    .dataId = data_id_r,
    .copy = copy,
  };

  int ret = receive_event(instance, UDS_EVT_ReadDataByIdent, &arg);
  zassert_ok(ret);

  zassert_true(data_id_check_fn_fake.call_count >= 1);
  zassert_equal(data_id_action_fn_fake.call_count, 1);
}

//////////////////////7

UDSErr_t custom_check_for_0x22_both_actions_are_executed(
    const struct uds_new_context *const context, bool *apply_action) {
  if (context->registration->type ==
          UDS_NEW_REGISTRATION_TYPE__DATA_IDENTIFIER &&
      context->registration->data_identifier.data_id ==
          data_id_rw_duplicated1 &&
      context->event == UDS_EVT_ReadDataByIdent) {
    *apply_action = true;
  }
  return UDS_OK;
}

UDSErr_t custom_action_for_0x22_both_actions_are_executed(
    struct uds_new_context *const context, bool *consume_event) {
  if (context->registration->type ==
          UDS_NEW_REGISTRATION_TYPE__DATA_IDENTIFIER &&
      context->registration->data_identifier.data_id ==
          data_id_rw_duplicated1 &&
      context->event == UDS_EVT_ReadDataByIdent) {
    *consume_event = false;
  }
  return UDS_OK;
}

ZTEST_F(lib_uds_new, test_0x22_read_by_id_both_actions_are_executed) {
  struct uds_new_instance_t *instance = fixture->instance;

  data_id_check_fn_fake.custom_fake =
      custom_check_for_0x22_both_actions_are_executed;
  data_id_action_fn_fake.custom_fake =
      custom_action_for_0x22_both_actions_are_executed;

  UDSRDBIArgs_t arg = {
    .dataId = data_id_r,
    .copy = copy,
  };

  int ret = receive_event(instance, UDS_EVT_ReadDataByIdent, &arg);
  zassert_ok(ret);

  zassert_true(data_id_check_fn_fake.call_count >= 1);
  zassert_equal(data_id_action_fn_fake.call_count, 2);
}

//////////////////////7
UDSErr_t custom_check_for_0x22_returns_action_returncode(
    const struct uds_new_context *const context, bool *apply_action) {
  if (context->registration->type ==
          UDS_NEW_REGISTRATION_TYPE__DATA_IDENTIFIER &&
      context->registration->data_identifier.data_id == data_id_r &&
      context->event == UDS_EVT_ReadDataByIdent) {
    *apply_action = true;
  }
  return UDS_OK;
}

UDSErr_t custom_action_for_0x22_returns_action_returncode(
    struct uds_new_context *const context, bool *consume_event) {
  if (context->registration->type ==
          UDS_NEW_REGISTRATION_TYPE__DATA_IDENTIFIER &&
      context->registration->data_identifier.data_id == data_id_r &&
      context->event == UDS_EVT_ReadDataByIdent) {
    *consume_event = false;
    return UDS_NRC_SecurityAccessDenied;
  }
  return UDS_OK;
}

ZTEST_F(lib_uds_new, test_0x22_read_by_id_returns_action_returncode) {
  struct uds_new_instance_t *instance = fixture->instance;

  data_id_check_fn_fake.custom_fake =
      custom_check_for_0x22_returns_action_returncode;
  data_id_action_fn_fake.custom_fake =
      custom_action_for_0x22_returns_action_returncode;

  uint32_t data = 0x11223344;

  UDSWDBIArgs_t arg = {
    .dataId = data_id_rw,
    .data = (uint8_t *)&data,
    .len = sizeof(data),
  };

  int ret = receive_event(instance, UDS_EVT_ReadDataByIdent, &arg);
  zassert_equal(ret, UDS_NRC_SecurityAccessDenied);

  zassert_true(data_id_check_fn_fake.call_count >= 1);
  zassert_equal(data_id_action_fn_fake.call_count, 1);
}
//////////////////////7
#ifdef CONFIG_UDS_USE_DYNAMIC_REGISTRATION

#define UDS_UNIQUE_DATA_ID 0xFEEF

UDSErr_t custom_check_for_0x22_dynamic_registration(
    const struct uds_new_context *const context, bool *apply_action) {
  if (context->registration->type ==
          UDS_NEW_REGISTRATION_TYPE__DATA_IDENTIFIER &&
      context->registration->data_identifier.data_id == UDS_UNIQUE_DATA_ID &&
      context->event == UDS_EVT_ReadDataByIdent) {
    test_dynamic_registration_check_invoked = true;
    *apply_action = true;
  }
  return UDS_OK;
}

UDSErr_t custom_action_for_0x22_dynamic_registration(
    struct uds_new_context *const context, bool *consume_event) {
  if (context->registration->type ==
          UDS_NEW_REGISTRATION_TYPE__DATA_IDENTIFIER &&
      context->registration->data_identifier.data_id == UDS_UNIQUE_DATA_ID &&
      context->event == UDS_EVT_ReadDataByIdent) {
    consume_event = false;
    test_dynamic_registration_action_invoked = true;
  }
  return UDS_OK;
}

ZTEST_F(lib_uds_new, test_0x22_read_by_id_dynamic_registration) {
  struct uds_new_instance_t *instance = fixture->instance;

  struct uds_new_registration_t reg;
  reg.type = UDS_NEW_REGISTRATION_TYPE__DATA_IDENTIFIER;
  reg.applies_to_event = uds_new_filter_for_data_by_id_event;
  reg.data_identifier.data_id = UDS_UNIQUE_DATA_ID;
  reg.data_identifier.read.check = custom_check_for_0x22_dynamic_registration;
  reg.data_identifier.read.action = custom_action_for_0x22_dynamic_registration;
  reg.data_identifier.write.check = NULL;
  reg.data_identifier.write.action = NULL;

  int ret = instance->register_event_handler(instance, reg);
  zassert_ok(ret);

  UDSRDBIArgs_t arg = {
    .dataId = UDS_UNIQUE_DATA_ID,
    .copy = copy,
  };

  ret = receive_event(instance, UDS_EVT_ReadDataByIdent, &arg);
  zassert_ok(ret);

  zassert_true(test_dynamic_registration_check_invoked);
  zassert_true(test_dynamic_registration_action_invoked);
}

//////////////////////7

ZTEST_F(lib_uds_new,
        test_0x22_read_by_id_dynamic_registration_with_no_read_fn_smoke_test) {
  struct uds_new_instance_t *instance = fixture->instance;

  struct uds_new_registration_t reg;
  reg.type = UDS_NEW_REGISTRATION_TYPE__DATA_IDENTIFIER;
  reg.applies_to_event = uds_new_filter_for_data_by_id_event;
  reg.data_identifier.data_id = UDS_UNIQUE_DATA_ID;
  reg.data_identifier.read.check = NULL;
  reg.data_identifier.read.action = NULL;
  reg.data_identifier.write.check = NULL;
  reg.data_identifier.write.action = NULL;

  int ret = instance->register_event_handler(instance, reg);
  zassert_ok(ret);

  UDSRDBIArgs_t arg = {
    .dataId = UDS_UNIQUE_DATA_ID,
    .copy = copy,
  };

  ret = receive_event(instance, UDS_EVT_ReadDataByIdent, &arg);
  zassert_equal(ret, UDS_NRC_RequestOutOfRange);
}
//////////////////////7

#endif  // CONFIG_UDS_USE_DYNAMIC_REGISTRATION
```

## src/test_0x23_read_memory_by_address.c
```c
/**
 * Copyright (c) Frickly Systems GmbH
 *
 * SPDX-License-Identifier: Apache-2.0
 */

#include "fixture.h"
#include "iso14229.h"
#include "zephyr/ztest_assert.h"

#include <zephyr/ztest.h>

#include <ardep/uds_new.h>

ZTEST_F(lib_uds_new, test_0x23_read_memory_by_address_null_address) {
  struct uds_new_instance_t *instance = fixture->instance;

  UDSReadMemByAddrArgs_t args = {
    .memAddr = NULL,
    .memSize = 16,
    .copy = copy,
  };

  int ret = receive_event(instance, UDS_EVT_ReadMemByAddr, &args);
  zassert_equal(ret, UDS_NRC_RequestOutOfRange);
}

ZTEST_F(lib_uds_new, test_0x23_read_memory_by_address_zero_size) {
  struct uds_new_instance_t *instance = fixture->instance;

  UDSReadMemByAddrArgs_t args = {
    .memAddr = (void*)0x10000,
    .memSize = 0,
    .copy = copy,
  };

  int ret = receive_event(instance, UDS_EVT_ReadMemByAddr, &args);
  zassert_equal(ret, UDS_NRC_RequestOutOfRange);
}

#if CONFIG_BOARD_NATIVE_SIM


ZTEST_F(lib_uds_new, test_0x23_read_memory_by_address_valid_memory) {
  struct uds_new_instance_t *instance = fixture->instance;

  const uint8_t local_buffer[16] = {0x01, 0x02, 0x03, 0x04, 0x05, 0x06, 0x07, 0x08,
                            0x09, 0x0A, 0x0B, 0x0C, 0x0D, 0x0E, 0x0F, 0x10};

  UDSReadMemByAddrArgs_t args = {
    .memAddr = local_buffer,
    .memSize = 16,
    .copy = copy,
  };

  int ret = receive_event(instance, UDS_EVT_ReadMemByAddr, &args);
  zassert_equal(ret, UDS_PositiveResponse);

  zassert_equal(copy_fake.call_count, 1);
  zassert_equal(copy_fake.arg0_val, &instance->iso14229.server);
  zassert_equal(copy_fake.arg2_val, sizeof(local_buffer));

  assert_copy_data(local_buffer, sizeof(local_buffer));
}
#endif


// We use a nucleo board with known memory layout
#if CONFIG_BOARD_NUCLEO_G474RE

// STM32G474RE memory layout (correct addresses for this MCU)
const uintptr_t known_ram_start = 0x20000000;  // SRAM start
const uintptr_t known_ram_end = 0x20020000;    // 128KB SRAM
const uintptr_t known_flash_start = 0x08000000; // Flash start
const uintptr_t known_flash_end = 0x08080000;   // 512KB Flash

// Test cases for real hardware with known memory layout
ZTEST_F(lib_uds_new, test_0x23_read_memory_by_address_nucleo_ram_valid) {
  struct uds_new_instance_t *instance = fixture->instance;

  // Test reading from valid RAM location
  UDSReadMemByAddrArgs_t args = {
    .memAddr = (void*)known_ram_start,
    .memSize = 4,
    .copy = copy,
  };

  int ret = receive_event(instance, UDS_EVT_ReadMemByAddr, &args);
  zassert_equal(ret, UDS_PositiveResponse);
  
  zassert_equal(copy_fake.call_count, 1);
  zassert_equal(copy_fake.arg0_val, &instance->iso14229.server);
  zassert_equal(copy_fake.arg2_val, 4);
}

ZTEST_F(lib_uds_new, test_0x23_read_memory_by_address_nucleo_ram_boundary_end) {
  struct uds_new_instance_t *instance = fixture->instance;

  // Test reading from RAM end boundary (should be valid up to end-1)
  UDSReadMemByAddrArgs_t args = {
    .memAddr = (void*)(known_ram_end - 1),
    .memSize = 1,
    .copy = copy,
  };

  int ret = receive_event(instance, UDS_EVT_ReadMemByAddr, &args);
  zassert_equal(ret, UDS_PositiveResponse);
  
  zassert_equal(copy_fake.call_count, 1);
  zassert_equal(copy_fake.arg2_val, 1);
}

ZTEST_F(lib_uds_new, test_0x23_read_memory_by_address_nucleo_ram_out_of_bounds) {
  struct uds_new_instance_t *instance = fixture->instance;

  // Test reading after RAM end (should fail)
  UDSReadMemByAddrArgs_t args = {
    .memAddr = (void*)known_ram_end,
    .memSize = 1,
    .copy = copy,
  };

  int ret = receive_event(instance, UDS_EVT_ReadMemByAddr, &args);
  zassert_equal(ret, UDS_NRC_RequestOutOfRange);
}

ZTEST_F(lib_uds_new, test_0x23_read_memory_by_address_nucleo_flash_valid) {
  struct uds_new_instance_t *instance = fixture->instance;

  // Test reading from valid Flash location
  UDSReadMemByAddrArgs_t args = {
    .memAddr = (void*)known_flash_start,
    .memSize = 4,
    .copy = copy,
  };

  int ret = receive_event(instance, UDS_EVT_ReadMemByAddr, &args);
  zassert_equal(ret, UDS_PositiveResponse);
  
  zassert_equal(copy_fake.call_count, 1);
  zassert_equal(copy_fake.arg0_val, &instance->iso14229.server);
  zassert_equal(copy_fake.arg2_val, 4);
}

ZTEST_F(lib_uds_new, test_0x23_read_memory_by_address_nucleo_flash_boundary_end) {
  struct uds_new_instance_t *instance = fixture->instance;

  // Test reading from Flash end boundary (should be valid up to end-1)
  UDSReadMemByAddrArgs_t args = {
    .memAddr = (void*)(known_flash_end - 1),
    .memSize = 1,
    .copy = copy,
  };

  int ret = receive_event(instance, UDS_EVT_ReadMemByAddr, &args);
  zassert_equal(ret, UDS_PositiveResponse);
  
  zassert_equal(copy_fake.call_count, 1);
  zassert_equal(copy_fake.arg2_val, 1);
}

ZTEST_F(lib_uds_new, test_0x23_read_memory_by_address_nucleo_flash_out_of_bounds) {
  struct uds_new_instance_t *instance = fixture->instance;

  // Test reading after Flash end (should fail)
  UDSReadMemByAddrArgs_t args = {
    .memAddr = (void*)known_flash_end,
    .memSize = 1,
    .copy = copy,
  };

  int ret = receive_event(instance, UDS_EVT_ReadMemByAddr, &args);
  zassert_equal(ret, UDS_NRC_RequestOutOfRange);
}

ZTEST_F(lib_uds_new, test_0x23_read_memory_by_address_nucleo_invalid_peripheral) {
  struct uds_new_instance_t *instance = fixture->instance;

  // Test reading from peripheral region (should fail as not RAM/Flash)
  UDSReadMemByAddrArgs_t args = {
    .memAddr = (void*)0x40000000, // GPIO peripheral base
    .memSize = 4,
    .copy = copy,
  };

  int ret = receive_event(instance, UDS_EVT_ReadMemByAddr, &args);
  zassert_equal(ret, UDS_NRC_RequestOutOfRange);
}

ZTEST_F(lib_uds_new, test_0x23_read_memory_by_address_nucleo_invalid_low_memory) {
  struct uds_new_instance_t *instance = fixture->instance;

  // Test reading from invalid low memory region
  UDSReadMemByAddrArgs_t args = {
    .memAddr = (void*)0x00001000, // Below Flash region
    .memSize = 4,
    .copy = copy,
  };

  int ret = receive_event(instance, UDS_EVT_ReadMemByAddr, &args);
  zassert_equal(ret, UDS_NRC_RequestOutOfRange);
}

ZTEST_F(lib_uds_new, test_0x23_read_memory_by_address_nucleo_ram_overflow) {
  struct uds_new_instance_t *instance = fixture->instance;

  // Test reading that would overflow past RAM end
  UDSReadMemByAddrArgs_t args = {
    .memAddr = (void*)(known_ram_end - 2),
    .memSize = 4, // Would read 2 bytes past end
    .copy = copy,
  };

  int ret = receive_event(instance, UDS_EVT_ReadMemByAddr, &args);
  zassert_equal(ret, UDS_NRC_RequestOutOfRange);
}

ZTEST_F(lib_uds_new, test_0x23_read_memory_by_address_nucleo_flash_overflow) {
  struct uds_new_instance_t *instance = fixture->instance;

  // Test reading that would overflow past Flash end
  UDSReadMemByAddrArgs_t args = {
    .memAddr = (void*)(known_flash_end - 2),
    .memSize = 4, // Would read 2 bytes past end
    .copy = copy,
  };

  int ret = receive_event(instance, UDS_EVT_ReadMemByAddr, &args);
  zassert_equal(ret, UDS_NRC_RequestOutOfRange);
}

ZTEST_F(lib_uds_new, test_0x23_read_memory_by_address_nucleo_large_read_ram) {
  struct uds_new_instance_t *instance = fixture->instance;

  // Test reading large amount from RAM (1KB)
  UDSReadMemByAddrArgs_t args = {
    .memAddr = (void*)known_ram_start,
    .memSize = 1024,
    .copy = copy,
  };

  int ret = receive_event(instance, UDS_EVT_ReadMemByAddr, &args);
  zassert_equal(ret, UDS_PositiveResponse);
  
  zassert_equal(copy_fake.call_count, 1);
  zassert_equal(copy_fake.arg2_val, 1024);
}

ZTEST_F(lib_uds_new, test_0x23_read_memory_by_address_nucleo_large_read_flash) {
  struct uds_new_instance_t *instance = fixture->instance;

  // Test reading large amount from Flash (1KB)
  UDSReadMemByAddrArgs_t args = {
    .memAddr = (void*)known_flash_start,
    .memSize = 1024,
    .copy = copy,
  };

  int ret = receive_event(instance, UDS_EVT_ReadMemByAddr, &args);
  zassert_equal(ret, UDS_PositiveResponse);
  
  zassert_equal(copy_fake.call_count, 1);
  zassert_equal(copy_fake.arg2_val, 1024);
}

ZTEST_F(lib_uds_new, test_0x23_read_memory_by_address_nucleo_before_ram) {
  struct uds_new_instance_t *instance = fixture->instance;

  // Test reading just before RAM
  UDSReadMemByAddrArgs_t args = {
    .memAddr = (void*)(known_ram_start - 1),
    .memSize = 4, // overlapping
    .copy = copy,
  };

  int ret = receive_event(instance, UDS_EVT_ReadMemByAddr, &args);
  zassert_equal(ret, UDS_NRC_RequestOutOfRange);
}

ZTEST_F(lib_uds_new, test_0x23_read_memory_by_address_nucleo_before_flash) {
  struct uds_new_instance_t *instance = fixture->instance;

  // Test reading just before Flash
  UDSReadMemByAddrArgs_t args = {
    .memAddr = (void*)(known_flash_start - 1),
    .memSize = 4, // overlapping
    .copy = copy,
  };

  int ret = receive_event(instance, UDS_EVT_ReadMemByAddr, &args);
  zassert_equal(ret, UDS_NRC_RequestOutOfRange);
}

#endif
```

## src/test_0x23_read_memory_by_address.h
```c
ZTEST_F(lib_uds_new, test_0x23_read_memory_by_address_null_address) {
  struct uds_new_instance_t *instance = fixture->instance;

  UDSReadMemByAddrArgs_t args = {
    .memAddr = NULL,
    .memSize = 16,
    .copy = copy,
  };

  int ret = receive_event(instance, UDS_EVT_ReadMemByAddr, &args);
  zassert_equal(ret, UDS_NRC_RequestOutOfRange);
}

ZTEST_F(lib_uds_new, test_0x23_read_memory_by_address_zero_size) {
  struct uds_new_instance_t *instance = fixture->instance;

  UDSReadMemByAddrArgs_t args = {
    .memAddr = (void*)0x10000,
    .memSize = 0,
    .copy = copy,
  };

  int ret = receive_event(instance, UDS_EVT_ReadMemByAddr, &args);
  zassert_equal(ret, UDS_NRC_RequestOutOfRange);
}

#if CONFIG_BOARD_NATIVE_SIM


ZTEST_F(lib_uds_new, test_0x23_read_memory_by_address_valid_memory) {
  struct uds_new_instance_t *instance = fixture->instance;

  const uint8_t local_buffer[16] = {0x01, 0x02, 0x03, 0x04, 0x05, 0x06, 0x07, 0x08,
                            0x09, 0x0A, 0x0B, 0x0C, 0x0D, 0x0E, 0x0F, 0x10};

  UDSReadMemByAddrArgs_t args = {
    .memAddr = local_buffer,
    .memSize = 16,
    .copy = copy,
  };

  int ret = receive_event(instance, UDS_EVT_ReadMemByAddr, &args);
  zassert_equal(ret, UDS_PositiveResponse);

  zassert_equal(copy_fake.call_count, 1);
  zassert_equal(copy_fake.arg0_val, &instance->iso14229.server);
  zassert_equal(copy_fake.arg2_val, sizeof(local_buffer));

  assert_copy_data(local_buffer, sizeof(local_buffer));
}
#endif


// We use a nucleo board with known memory layout
#if CONFIG_BOARD_NUCLEO_G474RE

// STM32G474RE memory layout (correct addresses for this MCU)
const uintptr_t known_ram_start = 0x20000000;  // SRAM start
const uintptr_t known_ram_end = 0x20020000;    // 128KB SRAM
const uintptr_t known_flash_start = 0x08000000; // Flash start
const uintptr_t known_flash_end = 0x08080000;   // 512KB Flash

// Test cases for real hardware with known memory layout
ZTEST_F(lib_uds_new, test_0x23_read_memory_by_address_nucleo_ram_valid) {
  struct uds_new_instance_t *instance = fixture->instance;

  // Test reading from valid RAM location
  UDSReadMemByAddrArgs_t args = {
    .memAddr = (void*)known_ram_start,
    .memSize = 4,
    .copy = copy,
  };

  int ret = receive_event(instance, UDS_EVT_ReadMemByAddr, &args);
  zassert_equal(ret, UDS_PositiveResponse);
  
  zassert_equal(copy_fake.call_count, 1);
  zassert_equal(copy_fake.arg0_val, &instance->iso14229.server);
  zassert_equal(copy_fake.arg2_val, 4);
}

ZTEST_F(lib_uds_new, test_0x23_read_memory_by_address_nucleo_ram_boundary_end) {
  struct uds_new_instance_t *instance = fixture->instance;

  // Test reading from RAM end boundary (should be valid up to end-1)
  UDSReadMemByAddrArgs_t args = {
    .memAddr = (void*)(known_ram_end - 1),
    .memSize = 1,
    .copy = copy,
  };

  int ret = receive_event(instance, UDS_EVT_ReadMemByAddr, &args);
  zassert_equal(ret, UDS_PositiveResponse);
  
  zassert_equal(copy_fake.call_count, 1);
  zassert_equal(copy_fake.arg2_val, 1);
}

ZTEST_F(lib_uds_new, test_0x23_read_memory_by_address_nucleo_ram_out_of_bounds) {
  struct uds_new_instance_t *instance = fixture->instance;

  // Test reading after RAM end (should fail)
  UDSReadMemByAddrArgs_t args = {
    .memAddr = (void*)known_ram_end,
    .memSize = 1,
    .copy = copy,
  };

  int ret = receive_event(instance, UDS_EVT_ReadMemByAddr, &args);
  zassert_equal(ret, UDS_NRC_RequestOutOfRange);
}

ZTEST_F(lib_uds_new, test_0x23_read_memory_by_address_nucleo_flash_valid) {
  struct uds_new_instance_t *instance = fixture->instance;

  // Test reading from valid Flash location
  UDSReadMemByAddrArgs_t args = {
    .memAddr = (void*)known_flash_start,
    .memSize = 4,
    .copy = copy,
  };

  int ret = receive_event(instance, UDS_EVT_ReadMemByAddr, &args);
  zassert_equal(ret, UDS_PositiveResponse);
  
  zassert_equal(copy_fake.call_count, 1);
  zassert_equal(copy_fake.arg0_val, &instance->iso14229.server);
  zassert_equal(copy_fake.arg2_val, 4);
}

ZTEST_F(lib_uds_new, test_0x23_read_memory_by_address_nucleo_flash_boundary_end) {
  struct uds_new_instance_t *instance = fixture->instance;

  // Test reading from Flash end boundary (should be valid up to end-1)
  UDSReadMemByAddrArgs_t args = {
    .memAddr = (void*)(known_flash_end - 1),
    .memSize = 1,
    .copy = copy,
  };

  int ret = receive_event(instance, UDS_EVT_ReadMemByAddr, &args);
  zassert_equal(ret, UDS_PositiveResponse);
  
  zassert_equal(copy_fake.call_count, 1);
  zassert_equal(copy_fake.arg2_val, 1);
}

ZTEST_F(lib_uds_new, test_0x23_read_memory_by_address_nucleo_flash_out_of_bounds) {
  struct uds_new_instance_t *instance = fixture->instance;

  // Test reading after Flash end (should fail)
  UDSReadMemByAddrArgs_t args = {
    .memAddr = (void*)known_flash_end,
    .memSize = 1,
    .copy = copy,
  };

  int ret = receive_event(instance, UDS_EVT_ReadMemByAddr, &args);
  zassert_equal(ret, UDS_NRC_RequestOutOfRange);
}

ZTEST_F(lib_uds_new, test_0x23_read_memory_by_address_nucleo_invalid_peripheral) {
  struct uds_new_instance_t *instance = fixture->instance;

  // Test reading from peripheral region (should fail as not RAM/Flash)
  UDSReadMemByAddrArgs_t args = {
    .memAddr = (void*)0x40000000, // GPIO peripheral base
    .memSize = 4,
    .copy = copy,
  };

  int ret = receive_event(instance, UDS_EVT_ReadMemByAddr, &args);
  zassert_equal(ret, UDS_NRC_RequestOutOfRange);
}

ZTEST_F(lib_uds_new, test_0x23_read_memory_by_address_nucleo_invalid_low_memory) {
  struct uds_new_instance_t *instance = fixture->instance;

  // Test reading from invalid low memory region
  UDSReadMemByAddrArgs_t args = {
    .memAddr = (void*)0x00001000, // Below Flash region
    .memSize = 4,
    .copy = copy,
  };

  int ret = receive_event(instance, UDS_EVT_ReadMemByAddr, &args);
  zassert_equal(ret, UDS_NRC_RequestOutOfRange);
}

ZTEST_F(lib_uds_new, test_0x23_read_memory_by_address_nucleo_ram_overflow) {
  struct uds_new_instance_t *instance = fixture->instance;

  // Test reading that would overflow past RAM end
  UDSReadMemByAddrArgs_t args = {
    .memAddr = (void*)(known_ram_end - 2),
    .memSize = 4, // Would read 2 bytes past end
    .copy = copy,
  };

  int ret = receive_event(instance, UDS_EVT_ReadMemByAddr, &args);
  zassert_equal(ret, UDS_NRC_RequestOutOfRange);
}

ZTEST_F(lib_uds_new, test_0x23_read_memory_by_address_nucleo_flash_overflow) {
  struct uds_new_instance_t *instance = fixture->instance;

  // Test reading that would overflow past Flash end
  UDSReadMemByAddrArgs_t args = {
    .memAddr = (void*)(known_flash_end - 2),
    .memSize = 4, // Would read 2 bytes past end
    .copy = copy,
  };

  int ret = receive_event(instance, UDS_EVT_ReadMemByAddr, &args);
  zassert_equal(ret, UDS_NRC_RequestOutOfRange);
}

ZTEST_F(lib_uds_new, test_0x23_read_memory_by_address_nucleo_large_read_ram) {
  struct uds_new_instance_t *instance = fixture->instance;

  // Test reading large amount from RAM (1KB)
  UDSReadMemByAddrArgs_t args = {
    .memAddr = (void*)known_ram_start,
    .memSize = 1024,
    .copy = copy,
  };

  int ret = receive_event(instance, UDS_EVT_ReadMemByAddr, &args);
  zassert_equal(ret, UDS_PositiveResponse);
  
  zassert_equal(copy_fake.call_count, 1);
  zassert_equal(copy_fake.arg2_val, 1024);
}

ZTEST_F(lib_uds_new, test_0x23_read_memory_by_address_nucleo_large_read_flash) {
  struct uds_new_instance_t *instance = fixture->instance;

  // Test reading large amount from Flash (1KB)
  UDSReadMemByAddrArgs_t args = {
    .memAddr = (void*)known_flash_start,
    .memSize = 1024,
    .copy = copy,
  };

  int ret = receive_event(instance, UDS_EVT_ReadMemByAddr, &args);
  zassert_equal(ret, UDS_PositiveResponse);
  
  zassert_equal(copy_fake.call_count, 1);
  zassert_equal(copy_fake.arg2_val, 1024);
}

ZTEST_F(lib_uds_new, test_0x23_read_memory_by_address_nucleo_before_ram) {
  struct uds_new_instance_t *instance = fixture->instance;

  // Test reading just before RAM
  UDSReadMemByAddrArgs_t args = {
    .memAddr = (void*)(known_ram_start - 1),
    .memSize = 4, // overlapping
    .copy = copy,
  };

  int ret = receive_event(instance, UDS_EVT_ReadMemByAddr, &args);
  zassert_equal(ret, UDS_NRC_RequestOutOfRange);
}

ZTEST_F(lib_uds_new, test_0x23_read_memory_by_address_nucleo_before_flash) {
  struct uds_new_instance_t *instance = fixture->instance;

  // Test reading just before Flash
  UDSReadMemByAddrArgs_t args = {
    .memAddr = (void*)(known_flash_start - 1),
    .memSize = 4, // overlapping
    .copy = copy,
  };

  int ret = receive_event(instance, UDS_EVT_ReadMemByAddr, &args);
  zassert_equal(ret, UDS_NRC_RequestOutOfRange);
}

#endif
```

## src/test_0x2E_write_data_by_id.c
```c
/*
 * Copyright (C) Frickly Systems GmbH
 * Copyright (C) MBition GmbH
 *
 * SPDX-License-Identifier: Apache-2.0
 */
#include "fixture.h"
#include "iso14229.h"
#include "zephyr/ztest_assert.h"

#include <zephyr/fff.h>
#include <zephyr/ztest.h>

#include <ardep/uds_new.h>

ZTEST_F(lib_uds_new,
        test_0x2E_write_by_id_fails_when_writing_to_readonly_element) {
  struct uds_new_instance_t *instance = fixture->instance;

  uint32_t data = 0x11223344;

  UDSWDBIArgs_t arg = {
    .dataId = data_id_rw,
    .data = (uint8_t *)&data,
    .len = sizeof(data),
  };

  int ret = receive_event(instance, UDS_EVT_WriteDataByIdent, &arg);
  zassert_equal(ret, UDS_NRC_RequestOutOfRange);
  zassert_true(data_id_check_fn_fake.call_count >= 1);
  zassert_equal(data_id_action_fn_fake.call_count, 0);
}

//////////////////////7

ZTEST_F(lib_uds_new, test_0x2E_write_by_id_fails_when_no_action_applies) {
  struct uds_new_instance_t *instance = fixture->instance;

  uint32_t data = 0x11223344;

  UDSWDBIArgs_t arg = {
    .dataId = data_id_rw,
    .data = (uint8_t *)&data,
    .len = sizeof(data),
  };

  int ret = receive_event(instance, UDS_EVT_WriteDataByIdent, &arg);
  zassert_equal(ret, UDS_NRC_RequestOutOfRange);
  zassert_true(data_id_check_fn_fake.call_count >= 1);
  zassert_equal(data_id_action_fn_fake.call_count, 0);
}

//////////////////////7

UDSErr_t custom_check_for_0x2E_applies_action_when_check_succeeds(
    const struct uds_new_context *const context, bool *apply_action) {
  if (context->registration->type ==
          UDS_NEW_REGISTRATION_TYPE__DATA_IDENTIFIER &&
      context->registration->data_identifier.data_id == data_id_rw &&
      context->event == UDS_EVT_WriteDataByIdent) {
    *apply_action = true;
  }
  return UDS_OK;
}

ZTEST_F(lib_uds_new, test_0x2E_write_by_id_applies_action_when_check_succeeds) {
  struct uds_new_instance_t *instance = fixture->instance;

  data_id_check_fn_fake.custom_fake =
      custom_check_for_0x2E_applies_action_when_check_succeeds;

  uint32_t data = 0x11223344;

  UDSWDBIArgs_t arg = {
    .dataId = data_id_rw,
    .data = (uint8_t *)&data,
    .len = sizeof(data),
  };

  int ret = receive_event(instance, UDS_EVT_WriteDataByIdent, &arg);
  zassert_ok(ret);

  zassert_true(data_id_check_fn_fake.call_count >= 1);
  zassert_equal(data_id_action_fn_fake.call_count, 1);
}

//////////////////////7

UDSErr_t custom_check_for_0x2E_consume_event_by_default_on_action(
    const struct uds_new_context *const context, bool *apply_action) {
  if (context->registration->type ==
          UDS_NEW_REGISTRATION_TYPE__DATA_IDENTIFIER &&
      context->registration->data_identifier.data_id ==
          data_id_rw_duplicated1 &&
      context->event == UDS_EVT_WriteDataByIdent) {
    *apply_action = true;
  }
  return UDS_OK;
}

ZTEST_F(lib_uds_new, test_0x2E_write_by_id_consume_event_by_default_on_action) {
  struct uds_new_instance_t *instance = fixture->instance;

  data_id_check_fn_fake.custom_fake =
      custom_check_for_0x2E_consume_event_by_default_on_action;

  uint32_t data = 0x11223344;

  UDSWDBIArgs_t arg = {
    .dataId = data_id_rw,
    .data = (uint8_t *)&data,
    .len = sizeof(data),
  };

  int ret = receive_event(instance, UDS_EVT_WriteDataByIdent, &arg);
  zassert_ok(ret);

  zassert_true(data_id_check_fn_fake.call_count >= 1);
  zassert_equal(data_id_action_fn_fake.call_count, 1);
}

// //////////////////////7

UDSErr_t custom_check_for_0x2E_both_actions_are_executed(
    const struct uds_new_context *const context, bool *apply_action) {
  if (context->registration->type ==
          UDS_NEW_REGISTRATION_TYPE__DATA_IDENTIFIER &&
      context->registration->data_identifier.data_id ==
          data_id_rw_duplicated1 &&
      context->event == UDS_EVT_WriteDataByIdent) {
    *apply_action = true;
  }
  return UDS_OK;
}

UDSErr_t custom_action_for_0x2E_both_actions_are_executed(
    struct uds_new_context *const context, bool *consume_event) {
  if (context->registration->type ==
          UDS_NEW_REGISTRATION_TYPE__DATA_IDENTIFIER &&
      context->registration->data_identifier.data_id ==
          data_id_rw_duplicated1 &&
      context->event == UDS_EVT_WriteDataByIdent) {
    *consume_event = false;
  }
  return UDS_OK;
}

ZTEST_F(lib_uds_new, test_0x2E_write_by_id_both_actions_are_executed) {
  struct uds_new_instance_t *instance = fixture->instance;

  data_id_check_fn_fake.custom_fake =
      custom_check_for_0x2E_both_actions_are_executed;
  data_id_action_fn_fake.custom_fake =
      custom_action_for_0x2E_both_actions_are_executed;

  uint32_t data = 0x11223344;

  UDSWDBIArgs_t arg = {
    .dataId = data_id_rw_duplicated1,
    .data = (uint8_t *)&data,
    .len = sizeof(data),
  };

  int ret = receive_event(instance, UDS_EVT_WriteDataByIdent, &arg);
  zassert_ok(ret);

  zassert_true(data_id_check_fn_fake.call_count >= 1);
  zassert_equal(data_id_action_fn_fake.call_count, 2);
}

// //////////////////////7

UDSErr_t custom_check_for_0x2E_returns_action_returncode(
    const struct uds_new_context *const context, bool *apply_action) {
  if (context->registration->type ==
          UDS_NEW_REGISTRATION_TYPE__DATA_IDENTIFIER &&
      context->registration->data_identifier.data_id ==
          data_id_rw_duplicated1 &&
      context->event == UDS_EVT_WriteDataByIdent) {
    *apply_action = true;
  }
  return UDS_OK;
}

UDSErr_t custom_action_for_0x2E_returns_action_returncode(
    struct uds_new_context *const context, bool *consume_event) {
  if (context->registration->type ==
          UDS_NEW_REGISTRATION_TYPE__DATA_IDENTIFIER &&
      context->registration->data_identifier.data_id ==
          data_id_rw_duplicated1 &&
      context->event == UDS_EVT_WriteDataByIdent) {
    *consume_event = false;
    return UDS_NRC_GeneralProgrammingFailure;
  }
  return UDS_OK;
}

ZTEST_F(lib_uds_new, test_0x2E_write_by_id_returns_action_returncode) {
  struct uds_new_instance_t *instance = fixture->instance;

  data_id_check_fn_fake.custom_fake =
      custom_check_for_0x2E_returns_action_returncode;
  data_id_action_fn_fake.custom_fake =
      custom_action_for_0x2E_returns_action_returncode;

  uint32_t data = 0x11223344;

  UDSWDBIArgs_t arg = {
    .dataId = data_id_rw,
    .data = (uint8_t *)&data,
    .len = sizeof(data),
  };

  int ret = receive_event(instance, UDS_EVT_WriteDataByIdent, &arg);
  zassert_equal(ret, UDS_NRC_GeneralProgrammingFailure);

  zassert_true(data_id_check_fn_fake.call_count >= 1);
  zassert_equal(data_id_action_fn_fake.call_count, 1);
}

// //////////////////////7
#ifdef CONFIG_UDS_USE_DYNAMIC_REGISTRATION

#define UDS_UNIQUE_DATA_ID 0xFEEF

UDSErr_t custom_check_for_dynamic_registration(
    const struct uds_new_context *const context, bool *apply_action) {
  if (context->registration->type ==
          UDS_NEW_REGISTRATION_TYPE__DATA_IDENTIFIER &&
      context->registration->data_identifier.data_id == UDS_UNIQUE_DATA_ID &&
      context->event == UDS_EVT_WriteDataByIdent) {
    test_dynamic_registration_check_invoked = true;
    *apply_action = true;
  }
  return UDS_OK;
}

UDSErr_t custom_action_for_dynamic_registration(
    struct uds_new_context *const context, bool *consume_event) {
  if (context->registration->type ==
          UDS_NEW_REGISTRATION_TYPE__DATA_IDENTIFIER &&
      context->registration->data_identifier.data_id == UDS_UNIQUE_DATA_ID &&
      context->event == UDS_EVT_WriteDataByIdent) {
    consume_event = false;
    test_dynamic_registration_action_invoked = true;
  }
  return UDS_OK;
}

ZTEST_F(lib_uds_new, test_0x2E_write_by_id_dynamic_registration) {
  struct uds_new_instance_t *instance = fixture->instance;

  struct uds_new_registration_t reg;
  reg.type = UDS_NEW_REGISTRATION_TYPE__DATA_IDENTIFIER;
  reg.applies_to_event = uds_new_filter_for_data_by_id_event;
  reg.data_identifier.data_id = UDS_UNIQUE_DATA_ID;
  reg.data_identifier.read.check = NULL;
  reg.data_identifier.read.action = NULL;
  reg.data_identifier.write.check = custom_check_for_dynamic_registration;
  reg.data_identifier.write.action = custom_action_for_dynamic_registration;

  int ret = instance->register_event_handler(instance, reg);
  zassert_ok(ret);

  uint32_t data = 0x11223344;

  UDSWDBIArgs_t arg = {
    .dataId = data_id_rw,
    .data = (uint8_t *)&data,
    .len = sizeof(data),
  };

  ret = receive_event(instance, UDS_EVT_WriteDataByIdent, &arg);
  zassert_ok(ret);

  zassert_true(test_dynamic_registration_check_invoked);
  zassert_true(test_dynamic_registration_action_invoked);
}

//////////////////////7

ZTEST_F(
    lib_uds_new,
    test_0x2E_write_by_id_dynamic_registration_with_no_write_fn_smoke_test) {
  struct uds_new_instance_t *instance = fixture->instance;

  struct uds_new_registration_t reg;
  reg.type = UDS_NEW_REGISTRATION_TYPE__DATA_IDENTIFIER;
  reg.applies_to_event = uds_new_filter_for_data_by_id_event;
  reg.data_identifier.data_id = UDS_UNIQUE_DATA_ID;
  reg.data_identifier.read.check = NULL;
  reg.data_identifier.read.action = NULL;
  reg.data_identifier.write.check = NULL;
  reg.data_identifier.write.action = NULL;

  int ret = instance->register_event_handler(instance, reg);
  zassert_ok(ret);

  uint32_t data = 0x11223344;

  UDSWDBIArgs_t arg = {
    .dataId = data_id_rw,
    .data = (uint8_t *)&data,
    .len = sizeof(data),
  };

  ret = receive_event(instance, UDS_EVT_WriteDataByIdent, &arg);
  zassert_equal(ret, UDS_NRC_RequestOutOfRange);
}
//////////////////////7

#endif  // CONFIG_UDS_USE_DYNAMIC_REGISTRATION
```
